// SPDX-License-Identifier: (GPL-2.0+ OR MIT)
/*
 * Author: Christian Hewitt <christianshewitt@gmail.com>
 */

&apb {
	mali: gpu@c0000 {
		compatible = "amlogic,meson-gxm-mali", "arm,mali-t820", "arm,mali-midgard";
		reg = <0x0 0xc0000 0x0 0x40000>;
		interrupt-parent = <&gic>;
		interrupts = <0 160 4>, <0 161 4>, <0 162 4>;
		interrupt-names = "gpu", "mmu", "job";
		clocks = <&clkc CLKID_MALI>;
		clock-names = "core";
		resets = <&reset RESET_MALI_CAPB3>, <&reset RESET_MALI>;
		reset-names = "apb", "gpu";

		/*
		 * Mali clocking is provided by two identical clock paths
		 * MALI_0 and MALI_1 muxed to a single clock by a glitch
		 * free mux to safely change frequency while running.
		 */
		assigned-clocks = <&clkc CLKID_MALI_0_SEL>,
				  <&clkc CLKID_MALI_0>,
				  <&clkc CLKID_MALI>; /* Glitch free mux */
		assigned-clock-parents = <&clkc CLKID_FCLK_DIV3>,
					 <0>, /* Do Nothing */
					 <&clkc CLKID_MALI_0>;
		assigned-clock-rates = <0>, /* Do Nothing */
				       <666666666>,
				       <0>; /* Do Nothing */
	};
};
