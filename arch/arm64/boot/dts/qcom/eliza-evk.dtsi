// SPDX-License-Identifier: BSD-3-Clause
/*
 * Copyright (c) Qualcomm Technologies, Inc. and/or its subsidiaries.
 */

/ {
	aliases {
		serial0 = &uart13;
	};

	chosen {
		stdout-path = "serial0:115200n8";
	};
};

&uart13 {
	compatible = "qcom,geni-debug-uart";

	status = "okay";
};
