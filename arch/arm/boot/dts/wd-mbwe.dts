/*
 * wd-mbwe.dtsi - Device tree file for Western Digital My Book World Edition
 *
 * Copyright (C) 2016 Neil Armstrong <narmstrong@baylibre.com>
 *
 * Licensed under GPLv2 or later
 */

/dts-v1/;
#include "ox810se.dtsi"

/ {
	model = "Western Digital My Book World Edition";

	compatible = "wd,mbwe", "plxtech,ox810se";

	chosen {
		bootargs = "console=ttyS1,115200n8 earlyprintk=serial";
	};

	memory {
		/* 128Mbytes DDR */
		reg = <0x48000000 0x8000000>;
	};
};

&uart1 {
	status = "okay";
};
