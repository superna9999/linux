## drivers/net/wireless/marvell/lrdmwl/Kconfig
```kconfig
config LRDMWL
	tristate "Laird wireless support based on Marvell chipsets (mac80211 compatible)"
	depends on MAC80211
	---help---
		Select to build the driver supporting the:

		Laird 60 Series Wi-Fi module

		This driver uses the kernel's mac80211 subsystem.

		If you want to compile the driver as a module (= code which can be
		inserted in and removed from the running kernel whenever you want),
		say M here and read <file:Documentation/kbuild/modules.txt>.  The
		module will be called lrdmwl.

config LRDMWL_PCIE
	tristate "Laird wireless support based on Marvell chipsets for PCIE"
	depends on LRDMWL && PCI
	select FW_LOADER
	---help---
		Select to build the driver supporting the:

		Laird 60 Series Wi-Fi module for PCIE

		This driver uses the kernel's mac80211 subsystem.

		If you want to compile the driver as a module (= code which can be
		inserted in and removed from the running kernel whenever you want),
		say M here and read <file:Documentation/kbuild/modules.txt>.  The
		module will be called lrdmwl_pcie.

config LRDMWL_SDIO
	tristate "Laird wireless support based on Marvell chipsets for SDIO"
	depends on LRDMWL && MMC
	select FW_LOADER
	---help---
		Select to build the driver supporting the:

		Laird 60 Series Wi-Fi module for SDIO

		This driver uses the kernel's mac80211 subsystem.

		If you want to compile the driver as a module (= code which can be
		inserted in and removed from the running kernel whenever you want),
		say M here and read <file:Documentation/kbuild/modules.txt>.  The
		module will be called lrdmwl_sdio.
```

## drivers/pci/pwrseq/Kconfig
```kconfig
# SPDX-License-Identifier: GPL-2.0

menu "PCI Power sequencing drivers"

config PCI_PWRSEQ
	bool

endmenu
```

## drivers/usb/repeater/Kconfig
```kconfig
# SPDX-License-Identifier: GPL-2.0

config USB_REPEATER
	tristate "USB Repeater Framework"
	help
	  Enable this to allow the USB PHY drivers and the connected repeater
	  driver to bind together and to provide the USB driver ways to perform
	  set of operations with repeater for USB2 functionality using PHY and
	  controller driver.

config QCOM_PMIC_EUSB2_REPEATER
	tristate "USB eUSB2 Repeater driver"
	select USB_REPEATER
	help
	  Enable this to support the USB eUSB2 repeater on Qualcomm PMIC chips.
	  This driver provides support to reset, initialize, power up and configure
	  the eUSB2 repeater for USB HS/FS/LS functionality where eUSB2 repeater
	  is used.

	  To compile the driver as a module, choose M here.
```

## security/hornet/Kconfig
```kconfig
# SPDX-License-Identifier: GPL-2.0-only
config SECURITY_HORNET
	bool "Hornet support"
	depends on SECURITY && BPF_SYSCALL
	select CRYPTO_LIB_SHA256
	select PKCS7_MESSAGE_PARSER
	select SYSTEM_DATA_VERIFICATION
	default n
	help
	  This selects Hornet.
	  Further information can be found in
	  Documentation/admin-guide/LSM/Hornet.rst.

	  If you are unsure how to answer this question, answer N.
```

## sound/soc/meson/Kconfig
```kconfig
menu "ASoC support for Amlogic platforms"
	depends on ARCH_MESON || COMPILE_TEST

config SND_MESON_AXG_FIFO
	tristate
	select REGMAP_MMIO

config SND_MESON_AXG_FRDDR
	tristate "Amlogic AXG Playback FIFO support"
	select SND_MESON_AXG_FIFO
	help
	  Select Y or M to add support for the frontend playback interfaces
	  embedded in the Amlogic AXG SoC family

config SND_MESON_AXG_TODDR
	tristate "Amlogic AXG Capture FIFO support"
	select SND_MESON_AXG_FIFO
	help
	  Select Y or M to add support for the frontend capture interfaces
	  embedded in the Amlogic AXG SoC family

config SND_MESON_AXG_TDM_FORMATTER
	tristate
	select REGMAP_MMIO

config SND_MESON_AXG_TDM_INTERFACE
	tristate
	select SND_MESON_AXG_TDM_FORMATTER

config SND_MESON_AXG_TDMIN
	tristate "Amlogic AXG TDM Input Support"
	select SND_MESON_AXG_TDM_FORMATTER
	select SND_MESON_AXG_TDM_INTERFACE
	help
	  Select Y or M to add support for TDM input formatter embedded
	  in the Amlogic AXG SoC family

config SND_MESON_AXG_TDMOUT
	tristate "Amlogic AXG TDM Output Support"
	select SND_MESON_AXG_TDM_FORMATTER
	select SND_MESON_AXG_TDM_INTERFACE
	help
	  Select Y or M to add support for TDM output formatter embedded
	  in the Amlogic AXG SoC family

config SND_MESON_AXG_SOUND_CARD
	tristate "Amlogic AXG Sound Card Support"
	select SND_MESON_AXG_TDM_INTERFACE
	imply SND_MESON_AXG_FRDDR
	imply SND_MESON_AXG_TODDR
	imply SND_MESON_AXG_TDMIN
	imply SND_MESON_AXG_TDMOUT
	imply SND_MESON_AXG_SPDIFOUT
	help
	  Select Y or M to add support for the AXG SoC sound card

config SND_MESON_AXG_SPDIFOUT
	tristate "Amlogic AXG SPDIF Output Support"
	select SND_PCM_IEC958
	imply SND_SOC_SPDIF
	help
	  Select Y or M to add support for SPDIF output serializer embedded
	  in the Amlogic AXG SoC family

endmenu

menuconfig SND_SOC_MESON
	tristate "ASoC support for Amlogic Meson SoCs"
	depends on ARCH_MESON
	select MFD_CORE
	select REGMAP_MMIO
	help
	  Say Y or M if you want to add support for codecs attached to
	  the Amlogic Meson SoCs Audio interfaces. You will also need to
	  select the audio interfaces to support below.

config SND_SOC_MESON_I2S
	tristate "Meson i2s interface"
	depends on SND_SOC_MESON
	help
	  Say Y or M if you want to add support for i2s driver for Amlogic
	  Meson SoCs.

config SND_SOC_MESON_SPDIF
	tristate "Meson spdif interface"
	depends on SND_SOC_MESON
	select SND_PCM_IEC958
	help
	  Say Y or M if you want to add support for spdif driver for Amlogic
	  Meson SoCs.
```
