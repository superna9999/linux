## Documentation/devicetree/bindings/clock/amlogic,meson-gxbb-pwm-mux.txt
```
Amlogic Meson GXBB PWM Clock Mux
================================

Required properties:
- compatible: Shall contain "amlogic,meson-gxbb-pwm-mux".
- #clock-cells: Should be 2.
- clock-output-names: Should contain unique 2 strings for each PWM mux

Example:
pwm_cd_mux: pwm-mux@8 {
	compatible = "amlogic,meson-gxbb-pwm-mux";
	reg = <0x0 0x8 0x0 0x4>;
	#clock-cells = <1>;
	clock-output-names = "pwm_c_mux", "pwm_d_mux";
};
```

## Documentation/devicetree/bindings/clock/amlogic,mmc-clkc.txt
```
* Amlogic MMC Sub Clock Controller Driver

The Amlogic MMC clock controller generates and supplies clock to support
MMC and NAND controller

Required Properties:

- compatible: should be:
		"amlogic,gx-mmc-clkc"
		"amlogic,axg-mmc-clkc"

- #clock-cells: should be 1.
- clocks: phandles to clocks corresponding to the clock-names property
- clock-names: list of parent clock names
	- "clkin0", "clkin1"

- reg: address of emmc sub clock register

Example: Clock controller node:

sd_mmc_c_clkc: clock-controller@7000 {
	compatible = "amlogic,axg-mmc-clkc", "syscon";
	reg = <0x0 0x7000 0x0 0x4>;
	#clock-cells = <1>;

	clock-names = "clkin0", "clkin1";
	clocks = <&clkc CLKID_SD_MMC_C_CLK0>,
		 <&clkc CLKID_FCLK_DIV2>;
};

sd_emmc_b_clkc: clock-controller@5000 {
	compatible = "amlogic,axg-mmc-clkc", "syscon";
	reg = <0x0 0x5000 0x0 0x4>;

	#clock-cells = <1>;
	clock-names = "clkin0", "clkin1";
	clocks = <&clkc CLKID_SD_EMMC_B_CLK0>,
		 <&clkc CLKID_FCLK_DIV2>;
};
```

## Documentation/devicetree/bindings/clock/plxtech,stdclk.txt
```
PLX Technology OXNAS SoC Family Standard Clocks
================================================

Please also refer to clock-bindings.txt in this directory for common clock
bindings usage.

Required properties:
- compatible: Should be "plxtech,ox810se-stdclk" or "plxtech,nas782x-stdclk"
- #clock-cells: 1, see below

Parent node should have the following properties :
- compatible: Should be "plxtech,ox810se-sys-ctrl", "syscon", "simple-mfd"

example:

sys: sys-ctrl@000000 {
	compatible = "plxtech,ox810se-sys-ctrl", "syscon", "simple-mfd";
	reg = <0x000000 0x100000>;

	stdclk: stdclk {
		compatible = "plxtech,ox810se-stdclk", "plxtech,nas782x-stdclk";
		#reset-cells = <1>;
	};
};
```

## Documentation/devicetree/bindings/display/msm/qcom,msm8996-dpu.yaml
```yaml
# SPDX-License-Identifier: GPL-2.0-only or BSD-2-Clause
%YAML 1.2
---
$id: http://devicetree.org/schemas/display/msm/qcom,msm8996-dpu.yaml#
$schema: http://devicetree.org/meta-schemas/core.yaml#

title: Qualcomm Display DPU dt properties for MSM8996 target

maintainers:
  - Konrad Dybcio <konrad.dybcio@linaro.org>

$ref: /schemas/display/msm/dpu-common.yaml#

properties:
  compatible:
    items:
      - const: qcom,msm8996-dpu

  reg:
    items:
      - description: Address offset and size for mdp register set
      - description: Address offset and size for vbif register set
      - description: Address offset and size for vbif_nrt register set

  reg-names:
    items:
      - const: mdp
      - const: vbif
      - const: vbif_nrt

  clocks:
    items:
      - description: Display ahb clock
      - description: Display axi clock
      - description: Display core clock
      - description: Display iommu clock
      - description: Display vsync clock

  clock-names:
    items:
      - const: iface
      - const: bus
      - const: core
      - const: iommu
      - const: vsync

unevaluatedProperties: false

examples:
  - |
    #include <dt-bindings/clock/qcom,mmcc-msm8996.h>
    #include <dt-bindings/interrupt-controller/arm-gic.h>
    #include <dt-bindings/power/qcom-rpmpd.h>

    display-controller@901000 {
        compatible = "qcom,msm8996-dpu";
        reg = <0x00901000 0x90000>,
              <0x009b0000 0x1040>,
              <0x009b8000 0x1040>;
        reg-names = "mdp", "vbif", "vbif_nrt";

        clocks = <&mmcc MDSS_AHB_CLK>,
                <&mmcc MDSS_AXI_CLK>,
                <&mmcc MDSS_MDP_CLK>,
                <&mmcc SMMU_MDP_AXI_CLK>,
                <&mmcc MDSS_VSYNC_CLK>;
        clock-names = "iface",
                      "bus",
                      "core",
                      "iommu",
                      "vsync";

        assigned-clocks = <&mmcc MDSS_MDP_CLK>,
                          <&mmcc MDSS_VSYNC_CLK>;
        assigned-clock-rates = <412500000>, <19200000>;

        operating-points-v2 = <&mdp_opp_table>;
        power-domains = <&rpmpd MSM8996_VDDMX>;

        interrupt-parent = <&mdss>;
        interrupts = <0>;

        ports {
            #address-cells = <1>;
            #size-cells = <0>;

            port@0 {
                reg = <0>;
                dpu_intf3_out: endpoint {
                    remote-endpoint = <&hdmi_in>;
                };
            };

            port@1 {
                reg = <1>;
                dpu_intf1_out: endpoint {
                    remote-endpoint = <&dsi0_in>;
                };
            };
        };
    };
...
```

## Documentation/devicetree/bindings/display/msm/qcom,msm8996-mdss.yaml
```yaml
# SPDX-License-Identifier: GPL-2.0-only or BSD-2-Clause
%YAML 1.2
---
$id: http://devicetree.org/schemas/display/msm/qcom,msm8996-mdss.yaml#
$schema: http://devicetree.org/meta-schemas/core.yaml#

title: Qualcomm MSM8996 Display MDSS

maintainers:
  - Konrad Dybcio <konrad.dybcio@linaro.org>

description:
  Device tree bindings for MSM Mobile Display Subsystem (MDSS) that encapsulates
  sub-blocks like DPU display controller, DSI and DP interfaces etc. Device tree
  bindings of MDSS are mentioned for MSM8996 target.

$ref: /schemas/display/msm/mdss-common.yaml#

properties:
  compatible:
    items:
      - const: qcom,msm8996-mdss

  clocks:
    items:
      - description: Display AHB clock from gcc
      - description: Display core clock

  iommus:
    maxItems: 1

  interconnects:
    maxItems: 2

  interconnect-names:
    maxItems: 2

patternProperties:
  "^display-controller@[0-9a-f]+$":
    type: object
    properties:
      compatible:
        const: qcom,msm8996-dpu

  "^dsi@[0-9a-f]+$":
    type: object
    properties:
      compatible:
        const: qcom,mdss-dsi-ctrl

  "^phy@[0-9a-f]+$":
    type: object
    properties:
      compatible:
        const: qcom,dsi-phy-14nm

unevaluatedProperties: false

examples:
  - |
    #include <dt-bindings/clock/qcom,mmcc-msm8996.h>
    #include <dt-bindings/clock/qcom,rpmcc.h>
    #include <dt-bindings/interrupt-controller/arm-gic.h>
    #include <dt-bindings/power/qcom-rpmpd.h>

    mdss: display-subsystem@900000 {
        compatible = "qcom,msm8996-mdss";
        reg = <0x00900000 0x1000>;
        reg-names = "mdss";
        power-domains = <&mmcc MDSS_GDSC>;

        clocks = <&mmcc MDSS_AHB_CLK>,
                 <&mmcc MDSS_MDP_CLK>;

        interrupts = <GIC_SPI 83 IRQ_TYPE_LEVEL_HIGH>;
        interrupt-controller;
        #interrupt-cells = <1>;

        iommus = <&mdp_smmu 0>;
        #address-cells = <1>;
        #size-cells = <1>;
        ranges;

        display-controller@901000 {
            compatible = "qcom,msm8996-dpu";
            reg = <0x00901000 0x90000>,
                  <0x009b0000 0x1040>,
                  <0x009b8000 0x1040>;
            reg-names = "mdp", "vbif", "vbif_nrt";

            clocks = <&mmcc MDSS_AHB_CLK>,
                     <&mmcc MDSS_AXI_CLK>,
                     <&mmcc MDSS_MDP_CLK>,
                     <&mmcc SMMU_MDP_AXI_CLK>,
                     <&mmcc MDSS_VSYNC_CLK>;
            clock-names = "iface", "bus", "core", "iommu", "vsync";

            assigned-clocks = <&mmcc MDSS_MDP_CLK>,
                              <&mmcc MDSS_VSYNC_CLK>;
            assigned-clock-rates = <412500000>, <19200000>;

            interrupt-parent = <&mdss>;
            interrupts = <0>;
            operating-points-v2 = <&mdp_opp_table>;
            power-domains = <&rpmpd MSM8996_VDDMX>;

            ports {
                #address-cells = <1>;
                #size-cells = <0>;

                port@0 {
                    reg = <0>;
                    dpu_intf3_out: endpoint {
                      remote-endpoint = <&hdmi_in>;
                    };
                };

                port@1 {
                    reg = <1>;
                    dpu_intf1_out: endpoint {
                      remote-endpoint = <&dsi0_in>;
                  };
                };
            };
        };

        dsi0: dsi@994000 {
            compatible = "qcom,mdss-dsi-ctrl";
            reg = <0x00994000 0x400>;
            reg-names = "dsi_ctrl";

            interrupt-parent = <&mdss>;
            interrupts = <4>;

            clocks = <&mmcc MDSS_MDP_CLK>,
                     <&mmcc MDSS_BYTE0_CLK>,
                     <&mmcc MDSS_AHB_CLK>,
                     <&mmcc MDSS_AXI_CLK>,
                     <&mmcc MMSS_MISC_AHB_CLK>,
                     <&mmcc MDSS_PCLK0_CLK>,
                     <&mmcc MDSS_ESC0_CLK>;
            clock-names = "mdp_core",
                          "byte",
                          "iface",
                          "bus",
                          "core_mmss",
                          "pixel",
                          "core";

            assigned-clocks = <&mmcc BYTE0_CLK_SRC>, <&mmcc PCLK0_CLK_SRC>;
            assigned-clock-parents = <&dsi0_phy 0>, <&dsi0_phy 1>;

            phys = <&dsi0_phy>;
            status = "disabled";

            #address-cells = <1>;
            #size-cells = <0>;

            ports {
                #address-cells = <1>;
                #size-cells = <0>;

                port@0 {
                    reg = <0>;
                    dsi0_in: endpoint {
                        remote-endpoint = <&dpu_intf1_out>;
                    };
                };

                port@1 {
                    reg = <1>;
                    dsi0_out: endpoint {
                    };
                };
              };
          };

          dsi0_phy: phy@994400 {
              compatible = "qcom,dsi-phy-14nm";
              reg = <0x00994400 0x100>,
                    <0x00994500 0x300>,
                    <0x00994800 0x188>;
              reg-names = "dsi_phy",
                          "dsi_phy_lane",
                          "dsi_pll";

              #clock-cells = <1>;
              #phy-cells = <0>;

              clocks = <&mmcc MDSS_AHB_CLK>, <&rpmcc RPM_SMD_BB_CLK1>;
              clock-names = "iface", "ref";
          };
    };
...
```

## Documentation/devicetree/bindings/display/msm/qcom,sm6350-dpu.yaml
```yaml
# SPDX-License-Identifier: GPL-2.0-only or BSD-2-Clause
%YAML 1.2
---
$id: http://devicetree.org/schemas/display/msm/qcom,sm6350-dpu.yaml#
$schema: http://devicetree.org/meta-schemas/core.yaml#

title: Qualcomm Display DPU dt properties for SM6350 target

maintainers:
  - Konrad Dybcio <konrad.dybcio@linaro.org>

$ref: /schemas/display/msm/dpu-common.yaml#

properties:
  compatible:
    items:
      - const: qcom,sm6350-dpu

  reg:
    items:
      - description: Address offset and size for mdp register set
      - description: Address offset and size for vbif register set

  reg-names:
    items:
      - const: mdp
      - const: vbif

  clocks:
    items:
      - description: Display axi clock
      - description: Display ahb clock
      - description: Display rot clock
      - description: Display lut clock
      - description: Display core clock
      - description: Display vsync clock

  clock-names:
    items:
      - const: bus
      - const: iface
      - const: rot
      - const: lut
      - const: core
      - const: vsync

unevaluatedProperties: false

examples:
  - |
    #include <dt-bindings/clock/qcom,dispcc-sm6350.h>
    #include <dt-bindings/clock/qcom,gcc-sm6350.h>
    #include <dt-bindings/power/qcom-rpmpd.h>

    display-controller@ae01000 {
        compatible = "qcom,sm6350-dpu";
        reg = <0x0ae01000 0x8f000>,
              <0x0aeb0000 0x2008>;
        reg-names = "mdp", "vbif";

        clocks = <&gcc GCC_DISP_AXI_CLK>,
                 <&dispcc DISP_CC_MDSS_AHB_CLK>,
                 <&dispcc DISP_CC_MDSS_ROT_CLK>,
                 <&dispcc DISP_CC_MDSS_MDP_LUT_CLK>,
                 <&dispcc DISP_CC_MDSS_MDP_CLK>,
                 <&dispcc DISP_CC_MDSS_VSYNC_CLK>;
        clock-names = "bus", "iface", "rot", "lut", "core",
                      "vsync";

        interrupt-parent = <&mdss>;
        interrupts = <0>;
        power-domains = <&rpmhpd SM6350_CX>;
        operating-points-v2 = <&mdp_opp_table>;

        ports {
            #address-cells = <1>;
            #size-cells = <0>;

            port@0 {
                reg = <0>;
                endpoint {
                    remote-endpoint = <&dsi0_in>;
                };
            };

            port@1 {
                reg = <1>;
                endpoint {
                    remote-endpoint = <&dsi1_in>;
                };
            };
        };
    };
...
```

## Documentation/devicetree/bindings/display/panel/sony,synaptics-jdi.yaml
```yaml
# SPDX-License-Identifier: (GPL-2.0-only OR BSD-2-Clause)
%YAML 1.2
---
$id: http://devicetree.org/schemas/display/panel/sony,synaptics-jdi.yaml#
$schema: http://devicetree.org/meta-schemas/core.yaml#

title: SONY Synaptics JDI panel

maintainers:
  - Konrad Dybcio <konrad.dybcio@somainline.org>

description: |
  This panel seems to only be found in SONY Xperia X, X Performance, X Compact,
  XZ and XZs smartphones and we have no straightforward way of actually getting
  the correct model number, as no schematics are released publicly.

allOf:
  - $ref: panel-common.yaml#

properties:
  compatible:
    items:
      - enum:
          - sony,synaptics-jdi-dora
          - sony,synaptics-jdi-kagura
          - sony,synaptics-jdi-keyaki
          - sony,synaptics-jdi-kugo
          - sony,synaptics-jdi-suzu

  reg: true

  avdd-supply:
    description: avdd supply

  vddio-supply:
    description: vddio supply

  vsn-supply:
    description: voltage negative supply

  vsp-supply:
    description: voltage positive supply

  tvdd-supply:
    description: tvdd supply

  preset-gpios:
    description: panel reset pin
    maxItems: 1

  pvddio-gpios:
    description: panel vddio pin
    maxItems: 1

  treset-gpios:
    description: touch reset pin
    maxItems: 1

required:
  - compatible
  - reg
  - preset-gpios
  - pvddio-gpios
  - treset-gpios
  - avdd-supply
  - vddio-supply
  - vsn-supply
  - vsp-supply
  - tvdd-supply

additionalProperties: false

examples:
  - |
    #include <dt-bindings/gpio/gpio.h>

    dsi {
        #address-cells = <1>;
        #size-cells = <0>;
        panel: panel@0 {
            reg = <0>;

            pvddio-gpios = <&tlmm 51 GPIO_ACTIVE_HIGH>;
            preset-gpios = <&tlmm 8 GPIO_ACTIVE_HIGH>;
            treset-gpios = <&tlmm 89 GPIO_ACTIVE_HIGH>;

            vddio-supply = <&pm8994_s4>;
            avdd-supply = <&pm8994_l2>;
            tvdd-supply = <&panel_tvdd>;

            backlight = <&pmi8994_wled>;

            port {
                panel_in: endpoint {
                   remote-endpoint = <&dsi0_out>;
                };
            };
        };
    };
```
