## Documentation/devicetree/bindings/pwm/pwm-meson-gxbb.txt
```
Amlogic Meson GXBB PWM Controller
=================================

Required properties:
- compatible: Shall contain "amlogic,meson-gxbb-pwm".
- #pwm-cells: Should be 3. See pwm.txt in this directory for a description of
  the cells format.
- clocks: Shall contain two clocks phandle for each of the two pwm controllers.
- clock-names: Shall contain at least the "clkin0" and "clkin1" names.

Example:
pwm_ab: pwm@8550 {
	compatible = "amlogic,meson-gxbb-pwm";
	reg = <0x0 0x08550 0x0 0x10>;
	#pwm-cells = <3>;
	status = "disabled";
	clocks = <&pwm_a_mux>, <&pwm_b_mux>;
	clock-names = "clkin0", "clkin1";
}
```

## Documentation/devicetree/bindings/reserved-memory/qcom,mpss-dsm-mem.yaml
```yaml
# SPDX-License-Identifier: (GPL-2.0-only OR BSD-2-Clause)
%YAML 1.2
---
$id: http://devicetree.org/schemas/reserved-memory/qcom,mpss-dsm-mem.yaml#
$schema: http://devicetree.org/meta-schemas/core.yaml#

title: Qualcomm Modem Processing SubSystem DSM Memory

description: |
  Qualcomm Modem Processing SubSystem DSM, which serves the purpose of
  describing the shared memory region used for MPSS remote processors.

maintainers:
  - Bjorn Andersson <andersson@kernel.org>

allOf:
  - $ref: reserved-memory.yaml

properties:
  compatible:
    const: qcom,mpss-dsm-mem

unevaluatedProperties: false

examples:
  - |
    reserved-memory {
        #address-cells = <1>;
        #size-cells = <1>;
        ranges;

        mpss-dsm@86700000 {
            compatible = "qcom,mpss-dsm-mem";
            reg = <0x86700000 0xe0000>;
            no-map;
        };
    };
```

## Documentation/devicetree/bindings/reset/plxtech,reset.txt
```
PLX Technology OXNAS SoC Family RESET Controller
================================================

Please also refer to reset.txt in this directory for common reset
controller binding usage.

Required properties:
- compatible: Should be "plxtech,nas782x-reset"
- #reset-cells: 1, see below

Parent node should have the following properties :
- compatible: Should be "plxtech,ox810se-sys-ctrl", "syscon", "simple-mfd"

example:

sys: sys-ctrl@000000 {
	compatible = "plxtech,ox810se-sys-ctrl", "syscon", "simple-mfd";
	reg = <0x000000 0x100000>;

	reset: reset-controller {
		compatible = "plxtech,nas782x-reset";
		#reset-cells = <1>;

	};
};
```

## Documentation/devicetree/bindings/soc/amlogic/amlogic,meson-canvas.txt
```
Amlogic Meson Canvas
================================

A canvas is a collection of metadata that describes a pixel buffer.
Those metadata include: width, height, phyaddr, wrapping, block mode
and endianness.

Many IPs within Amlogic SoCs rely on canvas indexes to read/write pixel data
rather than use the phy addresses directly. For instance, this is the case for
the video decoders and the display.

Amlogic SoCs have 256 canvas.

Device Tree Bindings:
---------------------

Canvas Provider
--------------------------

Required properties:
- compatible: "amlogic,meson-canvas"

Parent node should have the following properties :
- compatible: "amlogic,meson-gx-dmc-sysctrl", "syscon", "simple-mfd"
- reg: base address and size of the DMC system control register space.

Example:

sysctrl_DMC: system-controller@0 {
	compatible = "amlogic,meson-gx-dmc-sysctrl", "syscon", "simple-mfd";
	reg = <0x0 0x0 0x0 0x1000>;

	canvas: canvas-provider@0 {
		compatible = "amlogic,meson-canvas";
	};
};
```

## Documentation/devicetree/bindings/spi/spi-meson.txt
```
Amlogic Meson SPI controllers

* SPIFC (SPI Flash Controller)

The Meson SPIFC is a controller optimized for communication with SPI
NOR memories, without DMA support and a 64-byte unified transmit /
receive buffer.

Required properties:
 - compatible: should be "amlogic,meson6-spifc" or "amlogic,meson-gxbb-spifc"
 - reg: physical base address and length of the controller registers
 - clocks: phandle of the input clock for the baud rate generator
 - #address-cells: should be 1
 - #size-cells: should be 0

	spi@c1108c80 {
		compatible = "amlogic,meson6-spifc";
		reg = <0xc1108c80 0x80>;
		clocks = <&clk81>;
		#address-cells = <1>;
		#size-cells = <0>;
	};

* SPICC (SPI Communications Controller)

The Meson SPICC is generic SPI controller for general purpose Full-Duplex
communications with DMA support and separate 16bytes RX/TX PIO FIFOs.

Required properties:
 - compatible: should be "amlogic,meson-gx-spicc"
 - reg: physical base address and length of the controller registers
 - clocks: phandle of the input clock for the baud rate generator
 - #address-cells: should be 1
 - #size-cells: should be 0

Optional properties:
 - resets: phandle of the internal reset line

	spi@c1108d80 {
		compatible = "amlogic,meson-gx-spicc";
		reg = <0xc1108d80 0x80>;
		clocks = <&clk81>;
		#address-cells = <1>;
		#size-cells = <0>;
	};
```

## Documentation/devicetree/bindings/timer/plxtech,rps-timer.txt
```
PLX Technology OXNAS SoCs Family RPS Timer
==========================================

Required properties:
- compatible: Should be "plxtech,nas782x-rps-timer"
- reg : Specifies base physical address and size of the registers.
- interrupts : The interrupt of the first timer
- clocks : The phandle of the timer clock source

example:

timer0: timer@200 {
	compatible = "plxtech,nas782x-rps-timer";
	reg = <0x200 0x40>;
	clocks = <&rpsclk>;
	interrupts = <4 5>;
};
```

## Documentation/devicetree/bindings/usb/amlogic,dwc3.txt
```
Amlogic Meson GX DWC3 USB SoC controller

Required properties:
- compatible:	depending on the SoC this should contain one of:
			* amlogic,meson-axg-dwc3
			* amlogic,meson-gxl-dwc3
- clocks:	a handle for the "USB general" clock
- clock-names:	must be "usb_general"
- resets:	a handle for the shared "USB OTG" reset line
- reset-names:	must be "usb_otg"

Required child node:
A child node must exist to represent the core DWC3 IP block. The name of
the node is not important. The content of the node is defined in dwc3.txt.

PHY documentation is provided in the following places:
- Documentation/devicetree/bindings/phy/meson-gxl-usb2-phy.txt
- Documentation/devicetree/bindings/phy/meson-gxl-usb3-phy.txt

Example device nodes:
		usb0: usb@ff500000 {
			compatible = "amlogic,meson-axg-dwc3";
			#address-cells = <2>;
			#size-cells = <2>;
			ranges;

			clocks = <&clkc CLKID_USB>;
			clock-names = "usb_general";
			resets = <&reset RESET_USB_OTG>;
			reset-names = "usb_otg";

			dwc3: dwc3@ff500000 {
				compatible = "snps,dwc3";
				reg = <0x0 0xff500000 0x0 0x100000>;
				interrupts = <GIC_SPI 30 IRQ_TYPE_LEVEL_HIGH>;
				dr_mode = "host";
				maximum-speed = "high-speed";
				snps,dis_u2_susphy_quirk;
				phys = <&usb3_phy>, <&usb2_phy0>;
				phy-names = "usb2-phy", "usb3-phy";
			};
		};

Amlogic Meson G12A DWC3 USB SoC Controller Glue

The Amlogic G12A embeds a DWC3 USB IP Core configured for USB2 and USB3
in host-only mode, and a DWC2 IP Core configured for USB2 peripheral mode
only.

A glue connects the DWC3 core to USB2 PHYs and optionnaly to an USB3 PHY.

One of the USB2 PHY can be re-routed in peripheral mode to a DWC2 USB IP.

The DWC3 Glue controls the PHY routing and power, an interrupt line is
connected to the Glue to serve as OTG ID change detection.

Required properties:
- compatible:	Should be "amlogic,meson-g12a-usb-ctrl"
- clocks:	a handle for the "USB" clock
- clock-names:	must be "usb"
- resets:	a handle for the shared "USB" reset line
- reset-names:	must be "usb"
- reg:		The base address and length of the registers
- interrupts:	the interrupt specifier for the OTG detection

Required child nodes:

USB Ports are described as child 'port' nodes grouped under a 'ports' node,
with #address-cells, #size-cells specified.

Each 'port' sub-node identifies a possible USB Port served by an USB PHY
identified by the 'phy' property as decribed in ../phy/phy-bindings.txt

Each 'port' is identified by a reg property to number the port.

The following table lists for each supported model the port number
corresponding to each PHY serving a physical USB Port.

 Family	   Port 0     Port 1    Port 2    Port 3    Port 4
---------------------------------------------------------------
 G12A	   USBHOST_A  USBOTG_B  Reserved  Reserved  USB3_0

A child node must exist to represent the core DWC3 IP block. The name of
the node is not important. The content of the node is defined in dwc3.txt.

A child node must exist to represent the core DWC2 IP block. The name of
the node is not important. The content of the node is defined in dwc2.txt.

PHY documentation is provided in the following places:
- Documentation/devicetree/bindings/phy/meson-g12a-usb2-phy.txt
- Documentation/devicetree/bindings/phy/meson-g12a-usb3-pcie-phy.txt


Example device nodes:
	usb: usb@ffe09000 {
			compatible = "amlogic,meson-g12a-usb-ctrl";
			reg = <0x0 0xffe09000 0x0 0xa0>;
			interrupts = <GIC_SPI 16 IRQ_TYPE_LEVEL_HIGH>;
			#address-cells = <2>;
			#size-cells = <2>;
			ranges;

			clocks = <&clkc CLKID_USB>;
			clock-names = "usb";
			resets = <&reset RESET_USB>;
			reset-names = "usb";

			ports {
				#address-cells = <1>;
				#size-cells = <0>;

				/* USB2 Port 0 */
				usb20: port@0 {
					reg = <0>;
					phys = <&usb2_phy0>;
				};

				/* USB2 Port 1 */
				usb21: port@1 {
					reg = <1>;
					phys = <&usb2_phy1>;
				};

				/* USB3 Port 0 */
				usb3: port@4 {
					reg = <4>;
					phys = <&usb3_pcie_phy PHY_TYPE_USB3>;
				};
			};

			dwc2: usb@ff400000 {
				compatible = "amlogic,meson-g12a-usb", "snps,dwc2";
				reg = <0x0 0xff400000 0x0 0x40000>;
				interrupts = <GIC_SPI 31 IRQ_TYPE_LEVEL_HIGH>;
				clocks = <&clkc CLKID_USB1_DDR_BRIDGE>;
				clock-names = "ddr";
				dr_mode = "peripheral";
				g-rx-fifo-size = <192>;
				g-np-tx-fifo-size = <128>;
				g-tx-fifo-size = <128 128 16 16 16>;
			};

			dwc3: dwc3@ff500000 {
				compatible = "snps,dwc3";
				reg = <0x0 0xff500000 0x0 0x100000>;
				interrupts = <GIC_SPI 30 IRQ_TYPE_LEVEL_HIGH>;
				dr_mode = "host";
				snps,dis_u2_susphy_quirk;
				snps,quirk-frame-length-adjustment;
			};
	};
```

## Documentation/devicetree/bindings/usb/cadence-hsudc.txt
```
Cadence USB2.0 Device Controller

The Cadence USB2.0 Device Controller as verilog IP core library.

Required properties:
- compatible	: Should be "cdns,usbhs-udc"
- reg		: Physical base address and size of the USB2
			device registers map.
- interrupts	: Should contain single irq line of USB2 device
			controller
- cdns,ep-in	: Should be an array of u32 containing 1 for each available
			IN endpoint, endpoint 0 is mandatory,
			0 means not available, 16 entries max
- cdns,ep-out	: Should be an array of u32 containing 1 for each available
			OUT endpoint, endpoint 0 is mandatory
			0 means not available, 16 entries max
- cdns,ep-in-size	: Should be an array of u32 containing the max buffer
				size available for each IN endpoint,
				i.e. 64 for EP0, 512 for BULK, 1024 for ISO
- cdns,ep-in-buffers	: Should be an array of u32 containing the buffer
				count available for each IN endpoint,
				i.e. 1 for EP0 or BULK, 2 to 4 for ISO
- cdns,ep-in-buffstart	: Should be an array of u32 containing the buffer
				start offset for each IN endpoint
- cdns,ep-out-size	: Should be an array of u32 containing the max buffer
				size available for each OUT endpoint,
				i.e. 64 for EP0, 512 for BULK, 1024 for ISO
- cdns,ep-out-buffers	: Should be an array of u32 containing the buffer
				count available for each OUT endpoint,
				i.e. 1 for EP0 or BULK, 2 to 4 for ISO
- cdns,ep-out-buffstart	: Should be an array of u32 containing the buffer
				start offset for each OUT endpoint

Optional Properties :
- cdns,dma-enable	: Present of dma is present and must be enabled
- cdns,dma-channels	: If cdns,dma-enable is present, should be an u32
				containing the count of DMA channels
- clocks		: Should contain a phandle to the bus clock to enable

Example :
	usbd@80402000 {
		compatible = "cdns,usbhs-udc";
		interrupts = <25>;
		reg = <0x80402000 0x1000>;
		cdns,ep-in = <1 1 1>;
		cdns,ep-out = <1 1 1>;
		cdns,ep-in-size = <64 512 512>;
		cdns,ep-out-size = <64 512 512>;
		cdns,ep-in-buffers = <1 1 1>;
		cdns,ep-out-buffers = <1 1 1>;
		cdns,ep-in-buffstart = <0 64 576>;
		cdns,ep-out-buffstart = <0 64 576>;
		cdns,dma-enable;
		cdns,dma-channels = <4>;
	};
```

## Documentation/devicetree/bindings/usb/qcom,snps-eusb2-repeater.yaml
```yaml
# SPDX-License-Identifier: (GPL-2.0 OR BSD-2-Clause)
%YAML 1.2
---
$id: http://devicetree.org/schemas/usb/qcom,snps-eusb2-repeater.yaml#
$schema: http://devicetree.org/meta-schemas/core.yaml#

title: Qualcomm Synopsis eUSB2 to USB 2.0 repeater

maintainers:
  - Abel Vesa <abel.vesa@linaro.org>

properties:
  compatible:
    const: qcom,pm8550b-eusb2-repeater

  reg:
    maxItems: 1

  vdd18-supply: true

  vdd3-supply: true

required:
  - compatible
  - reg

additionalProperties: false

examples:
  - |
    #include <dt-bindings/spmi/spmi.h>
    pm8550b: pmic@7 {
        compatible = "qcom,pm8550", "qcom,spmi-pmic";
        reg = <0x7 SPMI_USID>;
        #address-cells = <1>;
        #size-cells = <0>;

        pm8550b_eusb2_repeater: usb-repeater@fd00 {
            compatible = "qcom,pm8550b-eusb2-repeater";
            reg = <0xfd00>;
        };
    };
...
```

## Documentation/devicetree/bindings/watchdog/meson-gxbb-wdt.txt
```
Meson GXBB SoCs Watchdog timer

Required properties:

- compatible : should be "amlogic,meson-gxbb-wdt"
- reg : Specifies base physical address and size of the registers.

Example:

wdt: watchdog@98d0 {
	compatible = "amlogic,meson-gxbb-wdt";
	reg = <0 0x98d0 0x0 0x10>;
};
```
