## Documentation/devicetree/bindings/display/panel/tdo,tl070wsh30.yaml
```yaml
# SPDX-License-Identifier: (GPL-2.0-only or BSD-2-Clause)
# Copyright 2020 BayLibre, SAS
%YAML 1.2
---
$id: http://devicetree.org/schemas/display/panel/tdo,tl070wsh30.yaml#
$schema: http://devicetree.org/meta-schemas/core.yaml#

title: TDO TL070WSH30 DSI panel

maintainers:
  - Neil Armstrong <narmstrong@baylibre.com>

allOf:
  - $ref: panel-common.yaml#

properties:

  compatible:
    enum:
      - tdo,tl070wsh30

  reg:
    maxItems: 1
    description: DSI virtual channel

  backlight: true
  reset-gpios: true
  port: true
  power-supply: true

additionalProperties: false

required:
  - compatible
  - power-supply
  - reset-gpios
  - port
  - reg

examples:
  - |
    dsi {
      #address-cells = <1>;
      #size-cells = <0>;
      panel@0 {
        compatible = "tdo,tl070wsh30";
        reg = <0>;
        power-supply = <&vcc_lcd_reg>;
        backlight = <&panel_backlight>;
        reset-gpios = <&gpio_reset>;

        port {
          panel: endpoint {
            remote-endpoint = <&mipi_dsi_out>;
          };
        };
      };
    };
```

## Documentation/devicetree/bindings/gpio/gpio-sx150x.txt
```
SEMTECH SX150x GPIO expander bindings


Required properties:

- compatible: should be "semtech,sx1506q",
			"semtech,sx1508q",
			"semtech,sx1509q",
			"semtech,sx1502q".

- reg: The I2C slave address for this device.

- interrupt-parent: phandle of the parent interrupt controller.

- interrupts: Interrupt specifier for the controllers interrupt.

- #gpio-cells: Should be 2. The first cell is the GPIO number and the
		second cell is used to specify optional parameters:
		bit 0: polarity (0: normal, 1: inverted)

- gpio-controller: Marks the device as a GPIO controller.

- interrupt-controller: Marks the device as a interrupt controller.

Optional Properties:
- oscio-is-gpo: Boolean, Indicated the oscio pin can be used as additional
		output gpo port.

- pull-up-ports: Array of port numbers which must have pull-up enabled.
- pull-down-ports: Array of port numbers which must have pull-down enabled.
- open-drain-ports: Array of port numbers which must be configured as open-drain,
			Push-Pull mode is default.
- polarity-invert-ports: Array of port numbers whih port polarity must be inverted.
- probe-reset: Boolean, Indicates the expander must be resetted.

The GPIO expander can optionally be used as an interrupt controller, in
which case it uses the default two cell specifier as described in
Documentation/devicetree/bindings/interrupt-controller/interrupts.txt.

Example:

	i2c_gpio_expander@20{
		#gpio-cells = <2>;
		#interrupt-cells = <2>;
		compatible = "semtech,sx1506q";
		reg = <0x20>;
		interrupt-parent = <&gpio_1>;
		interrupts = <16 0>;

		gpio-controller;
		interrupt-controller;

		pull-up-ports = <0 12>;
		pull-down-ports = <1 8>;
		open-drain-ports = <6 7 11>;
		polarity-invert-ports = <3>;
		probe-reset;
	};
```

## Documentation/devicetree/bindings/gpio/gpio_oxnas.txt
```
* PLX Technology OXNAS SoC GPIO Controller

Required properties:
 - compatible: "oxsemi,ox810se-gpio"
 - reg: Base address and length for the device.
 - interrupts: The port interrupt shared by all pins.
 - gpio-controller: Marks the port as GPIO controller.
 - #gpio-cells: Two. The first cell is the pin number and
   the second cell is used to specify the gpio polarity as defined in
   defined in <dt-bindings/gpio/gpio.h>:
      0 = GPIO_ACTIVE_HIGH
      1 = GPIO_ACTIVE_LOW
 - interrupt-controller: Marks the device node as an interrupt controller.
 - #interrupt-cells: Two. The first cell is the GPIO number and second cell
   is used to specify the trigger type as defined in
   <dt-bindings/interrupt-controller/irq.h>:
      IRQ_TYPE_EDGE_RISING
      IRQ_TYPE_EDGE_FALLING
      IRQ_TYPE_EDGE_BOTH
 - plxtech,gpio-bank: Specifies which bank a controller owns.
 - gpio-ranges: Interaction with the PINCTRL subsystem.
 - ngpios: Specifies the gpio lines count in this specific bank.

Example:

gpio0: gpio@0 {
	compatible = "oxsemi,ox810se-gpio";
	reg = <0x000000 0x100000>;
	interrupts = <21>;
	#gpio-cells = <2>;
	gpio-controller;
	interrupt-controller;
	#interrupt-cells = <2>;
	plxtech,gpio-bank = <0>;
	gpio-ranges = <&pinctrl 0 0 32>;
	ngpios = <32>;
};

keys {
	...

	button@sw1 {
		label = "ESC";
		linux,code = <1>;
		gpios = <&gpio0 12 0>;
	};
};
```

## Documentation/devicetree/bindings/interconnect/qcom,sm6115.yaml
```yaml
# SPDX-License-Identifier: (GPL-2.0 OR BSD-2-Clause)
%YAML 1.2
---
$id: http://devicetree.org/schemas/interconnect/qcom,sm6115.yaml#
$schema: http://devicetree.org/meta-schemas/core.yaml#

title: Qualcomm SM6115 Network-On-Chip interconnect

maintainers:
  - Bhupesh Sharma <bhupesh.sharma@linaro.org>

description: |
  The Qualcomm SM6115 interconnect providers support adjusting the
  bandwidth requirements between the various NoC fabrics.

properties:
  reg:
    maxItems: 1

  compatible:
    enum:
      - qcom,sm6115-bimc
      - qcom,sm6115-cnoc
      - qcom,sm6115-snoc

  '#interconnect-cells':
    const: 1

  clock-names:
    items:
      - const: bus
      - const: bus_a

  clocks:
    items:
      - description: Bus Clock
      - description: Bus A Clock

# Child node's properties
patternProperties:
  '^interconnect-[a-z0-9]+$':
    type: object
    description:
      The interconnect providers do not have a separate QoS register space,
      but share parent's space.

    properties:
      compatible:
        enum:
          - qcom,sm6115-clk-virt
          - qcom,sm6115-mmrt-virt
          - qcom,sm6115-mmnrt-virt

      '#interconnect-cells':
        const: 1

      clock-names:
        items:
          - const: bus
          - const: bus_a

      clocks:
        items:
          - description: Bus Clock
          - description: Bus A Clock

    required:
      - compatible
      - '#interconnect-cells'
      - clock-names
      - clocks

    additionalProperties: false

required:
  - compatible
  - reg
  - '#interconnect-cells'
  - clock-names
  - clocks

additionalProperties: false

examples:
  - |
    #include <dt-bindings/clock/qcom,rpmcc.h>

    snoc: interconnect@1880000 {
        compatible = "qcom,sm6115-snoc";
        reg = <0x01880000 0x60200>;
        #interconnect-cells = <1>;
        clock-names = "bus", "bus_a";
        clocks = <&rpmcc RPM_SMD_SNOC_CLK>,
                 <&rpmcc RPM_SMD_SNOC_A_CLK>;

        clk_virt: interconnect-clk {
            compatible = "qcom,sm6115-clk-virt";
            #interconnect-cells = <1>;
            clock-names = "bus", "bus_a";
            clocks = <&rpmcc RPM_SMD_QUP_CLK>,
                     <&rpmcc RPM_SMD_QUP_A_CLK>;
        };

        mmnrt_virt: interconnect-mmnrt {
            compatible = "qcom,sm6115-mmnrt-virt";
            #interconnect-cells = <1>;
            clock-names = "bus", "bus_a";
            clocks = <&rpmcc RPM_SMD_MMNRT_CLK>,
                     <&rpmcc RPM_SMD_MMNRT_A_CLK>;
        };

        mmrt_virt: interconnect-mmrt {
            compatible = "qcom,sm6115-mmrt-virt";
            #interconnect-cells = <1>;
            clock-names = "bus", "bus_a";
            clocks = <&rpmcc RPM_SMD_MMRT_CLK>,
                     <&rpmcc RPM_SMD_MMRT_A_CLK>;
        };
    };

    cnoc: interconnect@1900000 {
        compatible = "qcom,sm6115-cnoc";
        reg = <0x01900000 0x8200>;
        #interconnect-cells = <1>;
        clock-names = "bus", "bus_a";
        clocks = <&rpmcc RPM_SMD_CNOC_CLK>,
                 <&rpmcc RPM_SMD_CNOC_A_CLK>;
    };

    bimc: interconnect@4480000 {
        compatible = "qcom,sm6115-bimc";
        reg = <0x04480000 0x80000>;
        #interconnect-cells = <1>;
        clock-names = "bus", "bus_a";
        clocks = <&rpmcc RPM_SMD_BIMC_CLK>,
                 <&rpmcc RPM_SMD_BIMC_A_CLK>;
    };
```

## Documentation/devicetree/bindings/interconnect/qcom,sm6375.yaml
```yaml
# SPDX-License-Identifier: (GPL-2.0 OR BSD-2-Clause)
%YAML 1.2
---
$id: http://devicetree.org/schemas/interconnect/qcom,sm6375.yaml#
$schema: http://devicetree.org/meta-schemas/core.yaml#

title: Qualcomm SM6375 Network-On-Chip interconnect

maintainers:
  - Konrad Dybcio <konrad.dybcio@linaro.org>

description: |
  The Qualcomm SM6375 interconnect providers support adjusting the
  bandwidth requirements between the various NoC fabrics.

properties:
  reg:
    maxItems: 1

  compatible:
    enum:
      - qcom,sm6375-bimc
      - qcom,sm6375-cnoc
      - qcom,sm6375-snoc

  '#interconnect-cells':
    const: 1

  clock-names:
    items:
      - const: bus
      - const: bus_a

  clocks:
    items:
      - description: Bus Clock
      - description: Bus A Clock

# Child node's properties
patternProperties:
  '^interconnect-[a-z0-9]+$':
    type: object
    description:
      The interconnect providers do not have a separate QoS register space,
      but share parent's space.

    properties:
      compatible:
        enum:
          - qcom,sm6375-clk-virt
          - qcom,sm6375-mmrt-virt
          - qcom,sm6375-mmnrt-virt

      '#interconnect-cells':
        const: 1

      clock-names:
        items:
          - const: bus
          - const: bus_a

      clocks:
        items:
          - description: Bus Clock
          - description: Bus A Clock

    required:
      - compatible
      - '#interconnect-cells'
      - clock-names
      - clocks

    additionalProperties: false

required:
  - compatible
  - reg
  - '#interconnect-cells'
  - clock-names
  - clocks

additionalProperties: false

examples:
  - |
    #include <dt-bindings/clock/qcom,rpmcc.h>

    snoc: interconnect@1880000 {
        compatible = "qcom,sm6375-snoc";
        reg = <0x01880000 0x5f080>;
        clock-names = "bus", "bus_a";
        clocks = <&rpmcc RPM_SMD_SNOC_CLK>,
                 <&rpmcc RPM_SMD_SNOC_A_CLK>;
        #interconnect-cells = <1>;

        clk: interconnect-clk {
            compatible = "qcom,sm6375-clk-virt";
            clock-names = "bus", "bus_a";
            clocks = <&rpmcc RPM_SMD_QUP_CLK>,
                     <&rpmcc RPM_SMD_QUP_A_CLK>;
            #interconnect-cells = <1>;
        };

        mmnrt_virt: interconnect-mmnrt {
            compatible = "qcom,sm6375-mmnrt-virt";
            clock-names = "bus", "bus_a";
            clocks = <&rpmcc RPM_SMD_MMNRT_CLK>,
                     <&rpmcc RPM_SMD_MMNRT_A_CLK>;
            #interconnect-cells = <1>;
        };

        mmrt_virt: interconnect-mmrt {
            compatible = "qcom,sm6375-mmrt-virt";
            clock-names = "bus", "bus_a";
            clocks = <&rpmcc RPM_SMD_MMRT_CLK>,
                     <&rpmcc RPM_SMD_MMRT_A_CLK>;
            #interconnect-cells = <1>;
        };
    };

    config_noc: interconnect@1900000 {
        compatible = "qcom,sm6375-cnoc";
        reg = <0x01900000 0x6200>;
        clock-names = "bus", "bus_a";
        clocks = <&rpmcc RPM_SMD_CNOC_CLK>,
                 <&rpmcc RPM_SMD_CNOC_A_CLK>;
        #interconnect-cells = <1>;
    };

    bimc: interconnect@4480000 {
        compatible = "qcom,sm6375-bimc";
        reg = <0x04480000 0x80000>;
        clock-names = "bus", "bus_a";
        clocks = <&rpmcc RPM_SMD_BIMC_CLK>,
                 <&rpmcc RPM_SMD_BIMC_A_CLK>;
        #interconnect-cells = <1>;
    };
```

## Documentation/devicetree/bindings/interrupt-controller/plxtech,rps-irq.txt
```
PLX Technology OXNAS SoCs Family RPS Interrupt Controller
=========================================================

Required properties:
- compatible: Should be "plxtech,nas782x-rps"
- reg : Specifies base physical address and size of the registers.
- interrupt-controller : Identifies the node as an interrupt controller
- #interrupt-cells : Should be 1

example:

intc: interrupt-controller@0 {
	compatible = "plxtech,nas782x-rps";
	interrupt-controller;
	reg = <0 0x200>;
	#interrupt-cells = <1>;
};
```

## Documentation/devicetree/bindings/phy/amlogic,g12a-mipi-dphy-analog.yaml
```yaml
# SPDX-License-Identifier: (GPL-2.0 OR BSD-2-Clause)
%YAML 1.2
---
$id: "http://devicetree.org/schemas/phy/amlogic,g12a-mipi-dphy-analog.yaml#"
$schema: "http://devicetree.org/meta-schemas/core.yaml#"

title: Amlogic G12A MIPI analog PHY

maintainers:
  - Neil Armstrong <narmstrong@baylibre.com>

description: |+
  The Everything-Else Power Domains node should be the child of a syscon
  node with the required property:

  - compatible: Should be the following:
                "amlogic,meson-gx-hhi-sysctrl", "simple-mfd", "syscon"

  Refer to the the bindings described in
  Documentation/devicetree/bindings/mfd/syscon.yaml

properties:
  compatible:
    const: amlogic,g12a-mipi-dphy-analog

  "#phy-cells":
    const: 0

required:
  - compatible
  - "#phy-cells"

additionalProperties: false

examples:
  - |
    mpphy: phy {
          compatible = "amlogic,g12a-mipi-dphy-analog";
          #phy-cells = <0>;
    };
```

## Documentation/devicetree/bindings/pinctrl/plxtech,pinctrl.txt
```
PLX Technology OXNAS SoC Pinmux Controller
==========================================

The OXNAS Pinmux Controller, enables the IC to share one PAD to several
functional blocks. The sharing is done by multiplexing the PAD input/output
signals. For each PAD there are up to 8 muxing options (called periph modes).
Since different modules require different PAD settings
(like pull up, keeper, etc) the contoller controls also the PAD settings
parameters.

Please refer to pinctrl-bindings.txt in this directory for details of the
common pinctrl bindings used by client devices, including the meaning of the
phrase "pin configuration node".

OXNAS pin configuration node is a node of a group of pins which can be
used for a specific device or function. This node represents both mux and config
of the pins in that group. The 'pins' selects the function mode(also named pin
mode) this pin can work on and the 'config' configures various pad settings
such as pull-up, multi drive, etc.

Required properties for iomux controller:
- compatible: "oxsemi,ox810se-pinctrl"
- plxtech,mux-mask: array of mask (periph per bank) to describe if a pin can be
  configured in this periph mode. All the periph and bank need to be describe.
- plxtech,sys-ctrl: a phandle to the system controller syscon node

How to create such array:

Each column will represent the possible peripheral of the pinctrl
Each line will represent a pio bank

For example :
Peripheral: 2 ( A and B)
Bank: 2 (A, B and C)
=>

  /*    A         B     */
  0xffffffff 0xffc00c3b  /* pioA */
  0xffffffff 0x7fff3ccf  /* pioB */

For each peripheral/bank we will descibe in a u32 if a pin can be
configured in it by putting 1 to the pin bit (1 << pin)

Required properties for pin configuration node:
- plxtech,pins: 4 integers array, represents a group of pins mux and config
  setting. The format is plxtech,pins = <PIN_BANK PIN_BANK_NUM PERIPH CONFIG>.
  The PERIPH 0 means gpio, PERIPH 1 is periph A, PERIPH 2 is periph B...
  PIN_BANK 0 is pioA, PIN_BANK 1 is pioB...

Bits used for CONFIG:
 - None Yet

Examples:

pinctrl: pinctrl {
	compatible = "oxsemi,ox810se-pinctrl", "simple-bus";
	#address-cells = <1>;
	#size-cells = <1>;
	ranges;

	/* Regmap for sys registers */
	plxtech,sys-ctrl = <&sys>;

	/* Default, all-open mux-map */
	plxtech,mux-mask = <
		 0xFFFFFFFF 0xFFFFFFFF 0xFFFFFFFF 0xFFFFFFFF 0xFFFFFFFF
		 0xFFFFFFFF 0xFFFFFFFF 0xFFFFFFFF 0xFFFFFFFF 0xFFFFFFFF
		 >;

	uart0 {
		pinctrl_uart0: uart0 {
			plxtech,pins = <0 31 3 0
					0 32 3 0>;
		};
		pinctrl_uart0_modem: uart0_modem {
			plxtech,pins = <0 27 3 0
					0 28 3 0
					0 29 3 0
					0 30 3 0
					0 33 3 0
					0 34 3 0>;
		};
	};
};

uart0: uart@200000 {
	compatible = "ns16550a";
	reg = <0x200000 0x100000>;
	clocks = <&sysclk>;
	interrupts = <23>;
	reg-shift = <0>;
	fifo-size = <16>;
	reg-io-width = <1>;
	current-speed = <115200>;
	no-loopback-test;
	status = "disabled";
	resets = <&reset 17>;
	pinctrl-names = "default";
	pinctrl-0 = <&pinctrl_uart0>;
};
```
