## Documentation/devicetree/bindings/clock/amlogic,gxbb-clkc.yaml
```yaml
# SPDX-License-Identifier: (GPL-2.0-only OR BSD-2-Clause)
%YAML 1.2
---
$id: http://devicetree.org/schemas/clock/amlogic,gxbb-clkc.yaml#
$schema: http://devicetree.org/meta-schemas/core.yaml#

title: Amlogic Clock Controller

maintainers:
  - Neil Armstrong <neil.armstrong@linaro.org>

properties:
  compatible:
    enum:
      - amlogic,gxbb-clkc
      - amlogic,gxl-clkc
      - amlogic,axg-clkc
      - amlogic,g12a-clkc
      - amlogic,g12b-clkc
      - amlogic,sm1-clkc

  clocks:
    maxItems: 1

  clock-names:
    const: xtal

  '#clock-cells':
    const: 1

required:
  - compatible
  - clocks
  - clock-names
  - '#clock-cells'

unevaluatedProperties: false

examples:
  - |
    sysctrl: system-controller@0 {
        compatible = "amlogic,meson-gx-hhi-sysctrl", "simple-mfd", "syscon";
        reg = <0 0x400>;
 
        clkc: clock-controller {
            compatible = "amlogic,gxbb-clkc";
            #clock-cells = <1>;
            clocks = <&xtal>;
            clock-names = "xtal";
        };
    };
```

## Documentation/devicetree/bindings/clock/qcom,sm8650-lpasscorecc.yaml
```yaml
# SPDX-License-Identifier: (GPL-2.0-only OR BSD-2-Clause)
%YAML 1.2
---
$id: http://devicetree.org/schemas/clock/qcom,sm8650-lpasscorecc.yaml#
$schema: http://devicetree.org/meta-schemas/core.yaml#

title: Qualcomm LPASS Core & Audio Clock Controllers on SM8650

maintainers:
  - Neil Armstrong <neil.armstrong@linaro.org>

description: |
  Qualcomm LPASS HM, core, audio and AON clock controllers provide the clocks
  and power domains of the Low Power Audio SubSystem (LPASS) on SM8650, used
  when LPASS is driven by Linux instead of the ADSP firmware.

  See also:
    include/dt-bindings/clock/qcom,lpasscorecc-sm8650.h
    include/dt-bindings/clock/qcom,lpassaudiocc-sm8650.h

properties:
  compatible:
    enum:
      - qcom,sm8650-lpassaoncc
      - qcom,sm8650-lpassaudiocc
      - qcom,sm8650-lpasscorecc
      - qcom,sm8650-lpasshm

  reg:
    maxItems: 1

  clocks:
    minItems: 1
    maxItems: 2

  clock-names:
    minItems: 1
    maxItems: 2

  power-domains:
    maxItems: 1

  required-opps:
    maxItems: 1

  '#clock-cells':
    const: 1

  '#power-domain-cells':
    const: 1

required:
  - compatible
  - reg
  - clocks
  - clock-names
  - '#clock-cells'

allOf:
  - if:
      properties:
        compatible:
          contains:
            const: qcom,sm8650-lpasshm
    then:
      properties:
        clocks:
          items:
            - description: Board XO source
            - description: GCC LPASS config NoC SWAY clock
        clock-names:
          items:
            - const: bi_tcxo
            - const: iface
      required:
        - power-domains
        - '#power-domain-cells'

  - if:
      properties:
        compatible:
          contains:
            const: qcom,sm8650-lpasscorecc
    then:
      properties:
        clocks:
          items:
            - description: Board XO source
        clock-names:
          items:
            - const: bi_tcxo
        required-opps: false
      required:
        - power-domains

  - if:
      properties:
        compatible:
          contains:
            const: qcom,sm8650-lpassaoncc
    then:
      properties:
        clocks:
          items:
            - description: Board XO source
            - description: LPASS_CORE_CC_CORE_CLK
        clock-names:
          items:
            - const: bi_tcxo
            - const: iface
        power-domains: false
        required-opps: false
      required:
        - '#power-domain-cells'

  - if:
      properties:
        compatible:
          contains:
            const: qcom,sm8650-lpassaudiocc
    then:
      properties:
        clocks:
          items:
            - description: Board XO source
            - description: LPASS_AON_CC_MAIN_RCG_CLK_SRC
        clock-names:
          items:
            - const: bi_tcxo
            - const: iface
        required-opps: false
      required:
        - power-domains

additionalProperties: false

examples:
  - |
    #include <dt-bindings/clock/qcom,lpassaudiocc-sm8650.h>
    #include <dt-bindings/clock/qcom,lpasscorecc-sm8650.h>
    #include <dt-bindings/clock/qcom,sm8650-gcc.h>
    #include <dt-bindings/power/qcom,rpmhpd.h>

    clock-controller@6bc0000 {
        compatible = "qcom,sm8650-lpassaudiocc";
        reg = <0x06bc0000 0x38000>;
        clocks = <&bi_tcxo_div2>, <&lpass_aon LPASS_AON_CC_MAIN_RCG_CLK_SRC>;
        clock-names = "bi_tcxo", "iface";
        power-domains = <&lpass_aon LPASS_AON_CC_LPASS_AUDIO_HM_GDSC>;
        #clock-cells = <1>;
    };

    lpass_aon: clock-controller@6e00000 {
        compatible = "qcom,sm8650-lpassaoncc";
        reg = <0x06e00000 0x30000>;
        clocks = <&bi_tcxo_div2>, <&lpass_core LPASS_CORE_CC_CORE_CLK>;
        clock-names = "bi_tcxo", "iface";
        #clock-cells = <1>;
        #power-domain-cells = <1>;
    };

    lpass_core: clock-controller@7b00000 {
        compatible = "qcom,sm8650-lpasscorecc";
        reg = <0x07b00000 0x58000>;
        clocks = <&bi_tcxo_div2>;
        clock-names = "bi_tcxo";
        power-domains = <&lpass_hm LPASS_CORE_HM_GDSC>;
        #clock-cells = <1>;
    };

    lpass_hm: clock-controller@7e00000 {
        compatible = "qcom,sm8650-lpasshm";
        reg = <0x07e00000 0xa000>;
        clocks = <&bi_tcxo_div2>, <&gcc GCC_LPASS_CFG_NOC_SWAY_CLK>;
        clock-names = "bi_tcxo", "iface";
        power-domains = <&rpmhpd RPMHPD_LCX>;
        required-opps = <&rpmhpd_opp_nom>;
        #clock-cells = <1>;
        #power-domain-cells = <1>;
    };
...
```

## Documentation/devicetree/bindings/clock/qcom,sm8650-tcsr.yaml
```yaml
# SPDX-License-Identifier: (GPL-2.0-only OR BSD-2-Clause)
%YAML 1.2
---
$id: http://devicetree.org/schemas/clock/qcom,sm8650-tcsr.yaml#
$schema: http://devicetree.org/meta-schemas/core.yaml#

title: Qualcomm TCSR Clock Controller on SM8650

maintainers:
  - Bjorn Andersson <andersson@kernel.org>

description: |
  Qualcomm TCSR clock control module provides the clocks, resets and
  power domains on SM8650

  See also:: include/dt-bindings/clock/qcom,sm8650-tcsr.h

properties:
  compatible:
    items:
      - const: qcom,sm8650-tcsr
      - const: syscon

  clocks:
    items:
      - description: TCXO pad clock

  reg:
    maxItems: 1

  '#clock-cells':
    const: 1

  '#reset-cells':
    const: 1

required:
  - compatible
  - clocks

additionalProperties: false

examples:
  - |
    #include <dt-bindings/clock/qcom,rpmh.h>

    clock-controller@1fc0000 {
      compatible = "qcom,sm8650-tcsr", "syscon";
      reg = <0x1fc0000 0x30000>;
      clocks = <&rpmhcc RPMH_CXO_CLK>;
      #clock-cells = <1>;
      #reset-cells = <1>;
    };

...
```

## Documentation/devicetree/bindings/clock/qcom,tcsrcc-sm8550.yaml
```yaml
# SPDX-License-Identifier: (GPL-2.0-only OR BSD-2-Clause)
%YAML 1.2
---
$id: http://devicetree.org/schemas/clock/qcom,tcsrcc-sm8550.yaml#
$schema: http://devicetree.org/meta-schemas/core.yaml#

title: Qualcomm TCSR Clock Controller Binding for SM8550

maintainers:
  - Bjorn Andersson <andersson@kernel.org>

description: |
  Qualcomm TCSR clock control module which supports the clocks,
  resets and power domains on SM8550

  See also:
  - dt-bindings/clock/qcom,tcsrcc-sm8550.h

properties:
  compatible:
    const: qcom,sm8550-tcsrcc

  '#clock-cells':
    const: 1

  '#reset-cells':
    const: 1

  reg:
    maxItems: 1

required:
  - compatible

unevaluatedProperties: false

examples:
  - |
    clock-controller@1fc0000 {
      compatible = "qcom,sm8550-tcsrcc";
      reg = <0x1fc0000 0x30000>;
      #clock-cells = <1>;
      #reset-cells = <1>;
    };

...
```

## Documentation/devicetree/bindings/display/panel/renesas,r63419.yaml
```yaml
# SPDX-License-Identifier: (GPL-2.0-only OR BSD-2-Clause)
%YAML 1.2
---
$id: http://devicetree.org/schemas/display/panel/renesas,r63419.yaml#
$schema: http://devicetree.org/meta-schemas/core.yaml#

title: Renesas R63419 based dual-DSI video mode Display Panel

maintainers:
  - Neil Armstrong <neil.armstrong@linaro.org>

description:
  The Renesas R63419 is a generic DDIC used to control dual-DSI LCD panels.

allOf:
  - $ref: panel-common.yaml#

properties:
  compatible:
    enum:
      - ayaneo,wt0600-2k
      - ayaneo,wt0630-2k

  reg:
    maxItems: 1

  vdd-supply: true
  vddio-supply: true
  vsp-supply: true
  vsn-supply: true
  vci-supply: true

  backlight: true
  reset-gpios: true
  rotation: true
  ports: true

required:
  - compatible
  - vdd-supply
  - vddio-supply
  - vsp-supply
  - vsn-supply
  - vci-supply
  - backlight
  - reset-gpios
  - ports

additionalProperties: false

examples:
  - |
    #include <dt-bindings/gpio/gpio.h>

    dsi {
        #address-cells = <1>;
        #size-cells = <0>;

        panel@0 {
            compatible = "ayaneo,wt0600-2k";
            reg = <0>;

            reset-gpios = <&gpio 176 GPIO_ACTIVE_LOW>;

            vdd-supply = <&vdd_3v0_lcd>;
            vddio-supply = <&vdd_1v8_io>;
            vsn-supply = <&vdd_5v0_pos>;
            vsp-supply = <&vdd_5v0_neg>;
            vci-supply = <&vdd_3v0_vci>;

            backlight = <&backlight>;

            ports {
                #address-cells = <1>;
                #size-cells = <0>;

                port@0 {
                    reg = <0>;
                    panel_in0: endpoint {
                        remote-endpoint = <&dsi0_out>;
                    };
                };

                port@1 {
                    reg = <1>;
                    panel_in1: endpoint {
                        remote-endpoint = <&dsi1_out>;
                    };
                };
            };
        };
    };
...
```

## Documentation/devicetree/bindings/iio/adc/adi,max34417.yaml
```yaml
# SPDX-License-Identifier: (GPL-2.0 OR BSD-2-Clause)
%YAML 1.2
---
$id: http://devicetree.org/schemas/iio/adc/adi,max34417.yaml#
$schema: http://devicetree.org/meta-schemas/core.yaml#

title: Analog Devices MAX34417 Four-Channel High Dynamic Range Power Accumulator

maintainers:
  - Neil Armstrong <neil.armstrong@linaro.org>

description: |
  The MAX34417 is a specialized current and voltage monitor used to determine
  power consumption of portable systems. The device has a very wide dynamic
  range (20,000:1) that allows for the accurate measurement of power in such
  systems. The device is configured and monitored with a standard I2C/SMBus
  serial interface. The unidirectional current sensor offers precision
  high-side operation with a low full-scale sense voltage.

  Specifications about the device can be found at:
  https://www.analog.com/media/en/technical-documentation/data-sheets/max34417.pdf

properties:
  compatible:
    const: adi,max34417

  reg:
    maxItems: 1

  "#address-cells":
    const: 1

  "#size-cells":
    const: 0

  vdd-supply: true
  vio-supply: true

patternProperties:
  "^channel@[0-3]$":
    $ref: adc.yaml
    type: object
    description:
      Represents the internal channels of the sensor.

    properties:
      reg:
        items:
          - minimum: 0
            maximum: 3

      shunt-resistor-micro-ohms:
        description:
          Value in micro Ohms of the shunt resistor connected between the RS+ and RS- inputs.
        minimum: 1000
        maximum: 100000
        default: 1000

    required:
      - reg

    unevaluatedProperties: false

required:
  - compatible
  - reg
  - vdd-supply
  - vio-supply

additionalProperties: false

examples:
  - |
    i2c {
        #address-cells = <1>;
        #size-cells = <0>;

        sensor@10 {
              compatible = "adi,max34417";
              reg = <0x10>;

              vdd-supply = <&max34417_vdd>;
              vio-supply = <&max34417_vio>;

              #address-cells = <1>;
              #size-cells = <0>;

              channel@0 {
                  reg = <0>;
                  label = "ch0";
                  shunt-resistor-micro-ohms = <5000>;
              };

              channel@1 {
                  reg = <1>;
                  label = "ch1";
             };

              channel@2 {
                  reg = <2>;
             };
        };
    };
```

## Documentation/devicetree/bindings/iio/adc/maxim,max34417.yaml
```yaml
# SPDX-License-Identifier: (GPL-2.0 OR BSD-2-Clause)
%YAML 1.2
---
$id: http://devicetree.org/schemas/iio/adc/maxim,max34417.yaml#
$schema: http://devicetree.org/meta-schemas/core.yaml#

title: Maxim MAX34417 Four-Channel High Dynamic Range Power Accumulator

maintainers:
  - Neil Armstrong <neil.armstrong@linaro.org>

description: |
  The MAX34417 is a specialized current and voltage monitor used to determine
  power consumption of portable systems. The device has a very wide dynamic
  range (20,000:1) that allows for the accurate measurement of power in such
  systems. The device is configured and monitored with a standard I2C/SMBus
  serial interface. The unidirectional current sensor offers precision
  high-side operation with a low full-scale sense voltage.

  Specifications about the device can be found at:
  https://www.analog.com/media/en/technical-documentation/data-sheets/max34417.pdf

properties:
  compatible:
    const: maxim,max34417

  "#address-cells":
    const: 1

  "#size-cells":
    const: 0

  reg:
    maxItems: 1

  vdd-supply: true
  vio-supply: true

patternProperties:
  "^channel@[0-3]$":
    $ref: adc.yaml
    type: object
    description:
      Represents the internal channels of the sensor.

    properties:
      reg:
        items:
          - minimum: 0
            maximum: 3

      label: true

      maxim,rsense-val-micro-ohms:
        description:
          Adjust the Rsense value to the resistor value
        enum: [1000, 2000, 4000, 5000, 10000, 15000, 20000, 25000, 40000, 50000, 100000]
        default: 1000

    required:
      - reg
      - maxim,rsense-val-micro-ohms

    unevaluatedProperties: false

required:
  - compatible
  - reg

additionalProperties: false

examples:
  - |
    #include <dt-bindings/gpio/gpio.h>

    i2c {
        #address-cells = <1>;
        #size-cells = <0>;

        sensor@10 {
              compatible = "maxim,max34417";
              reg = <0x10>;

              #address-cells = <1>;
              #size-cells = <0>;

              channel@0 {
                  reg = <0>;
                  label = "ch0";
                  maxim,rsense-val-micro-ohms = <5000>;
              };

              channel@1 {
                  reg = <1>;
                  label = "ch1";
                  maxim,rsense-val-micro-ohms = <10000>;
             };
        };
    };
```
