## Documentation/devicetree/bindings/regulator/sgmicro,sgm3804.yaml
```yaml
# SPDX-License-Identifier: (GPL-2.0 OR BSD-2-Clause)
%YAML 1.2
---
$id: http://devicetree.org/schemas/regulator/sgmicro,sgm3804.yaml#
$schema: http://devicetree.org/meta-schemas/core.yaml#

title: SG Micro SGM3804 Single Inductor Dual Output Buck/Boost Converter

maintainers:
  - Neil Armstrong <neil.armstrong@linaro.org>

description:
  The SGM3804 is a dual voltage regulator, designed to support positive/negative
  supply for driving LCD panels. It support software-configurable output
  switching. The output voltages can be programmed via an I2C compatible interface.

properties:
  compatible:
    const: sgmicro,sgm3804

  reg:
    maxItems: 1

  enable-gpios:
    minItems: 2
    description:
      GPIO specifiers to enable the positive and negative outputs.

  vin-supply: true

patternProperties:
  "^(pos|neg)$":
    type: object
    $ref: regulator.yaml#
    unevaluatedProperties: false

required:
  - compatible
  - reg
  - enable-gpios
  - pos
  - neg

additionalProperties: false

examples:
  - |
    #include <dt-bindings/gpio/gpio.h>

    i2c {
        #address-cells = <1>;
        #size-cells = <0>;

        regulator@3e {
            compatible = "sgmicro,sgm3804";
            reg = <0x3e>;

            vin-supply = <&vin_reg>;

            enable-gpios = <&gpio 17 GPIO_ACTIVE_LOW>,
                           <&gpio 18 GPIO_ACTIVE_LOW>;

            pos {
                regulator-name = "outpos";
                regulator-min-microvolt = <5000000>;
                regulator-max-microvolt = <5000000>;
            };

            neg {
                regulator-name = "outneg";
                regulator-min-microvolt = <5000000>;
                regulator-max-microvolt = <5000000>;
            };
        };
    };
...
```

## Documentation/devicetree/bindings/sound/linux,spdif-dir.yaml
```yaml
# SPDX-License-Identifier: GPL-2.0
%YAML 1.2
---
$id: http://devicetree.org/schemas/sound/linux,spdif-dir.yaml#
$schema: http://devicetree.org/meta-schemas/core.yaml#

title: Dummy SPDIF Receiver

maintainers:
  - Mark Brown <broonie@kernel.org>

allOf:
  - $ref: dai-common.yaml#

properties:
  compatible:
    const: linux,spdif-dir

  "#sound-dai-cells":
    const: 0

  sound-name-prefix: true

required:
  - "#sound-dai-cells"
  - compatible

addirionalProperties: false

examples:
  - |
    spdif-in {
        #sound-dai-cells = <0>;
        compatible = "linux,spdif-dir";
    };

...
```

## Documentation/devicetree/bindings/sound/qcom,q6apm-lpass-dais.yaml
```yaml
# SPDX-License-Identifier: GPL-2.0 OR BSD-2-Clause
%YAML 1.2
---
$id: http://devicetree.org/schemas/sound/qcom,q6apm-lpass-dais.yaml#
$schema: http://devicetree.org/meta-schemas/core.yaml#

title: Qualcomm DSP LPASS (Low Power Audio SubSystem) Audio Ports

maintainers:
  - Krzysztof Kozlowski <krzk@kernel.org>
  - Srinivas Kandagatla <srinivas.kandagatla@linaro.org>

allOf:
  - $ref: dai-common.yaml#

properties:
  compatible:
    enum:
      - qcom,q6apm-lpass-dais

  '#sound-dai-cells':
    const: 1

  '#address-cells':
    const: 1

  '#size-cells':
    const: 0

# Digital Audio Interfaces
patternProperties:
  '^dai@[0-9]+$':
    type: object
    description:
      Q6DSP Digital Audio Interfaces.

    properties:
      reg:
        maxItems: 1
        description:
          Digital Audio Interface ID

      clocks:
        minItems: 1
        items:
          - description: MI2S master clock
          - description: MI2S bit clock
          - description: MI2S external bit clock

      clock-names:
        minItems: 1
        items:
          - const: mclk
          - const: bclk
          - const: eclk

    dependencies:
      clocks: [ clock-names ]
      clock-names: [ clocks ]

    required:
      - reg

    additionalProperties: false

required:
  - compatible
  - '#sound-dai-cells'

unevaluatedProperties: false

examples:
  - |
    #include <dt-bindings/sound/qcom,q6afe.h>

    dais {
        compatible = "qcom,q6apm-lpass-dais";
        #sound-dai-cells = <1>;
        #address-cells = <1>;
        #size-cells = <0>;

        dai@16 {
           reg = <PRIMARY_MI2S_RX>;
           clocks = <&q6prmcc LPASS_CLK_ID_MCLK_1
                              LPASS_CLK_ATTRIBUTE_COUPLE_NO>,
                    <&q6prmcc LPASS_CLK_ID_PRI_MI2S_IBIT
                              LPASS_CLK_ATTRIBUTE_COUPLE_NO>,
                    <&q6prmcc LPASS_CLK_ID_PRI_MI2S_EBIT
                              LPASS_CLK_ATTRIBUTE_COUPLE_NO>;
           clock-names = "mclk", "bclk", "eclk";
        };
    };
```

## Documentation/devicetree/bindings/usb/gpio-superspeed-switch.yaml
```yaml
# SPDX-License-Identifier: GPL-2.0-only OR BSD-2-Clause
%YAML 1.2
---
$id: "http://devicetree.org/schemas/usb/gpio-superspeed-switch.yaml#"
$schema: "http://devicetree.org/meta-schemas/core.yaml#"

title: GPIO-based SuperSpeed switch

maintainers:
  - Neil Armstrong <neil.armstrong@linaro.org>

description:
  In USB Type-C applications the USB SuperSpeed lanes must be switched depending
  on the orientation of the Type-C plug. This binding describes a family of
  hardware solutions which analog switches pairs of differential high-speed
  lanes using a GPIO signal.

properties:
  compatible:
    items:
      - enum:
          - wcn,ch482d
      - const: gpio-superspeed-switch

  enable-gpios:
    description: Switch enable GPIO

  select-gpios:
    description: Orientation select

  vcc-supply:
    description: power supply

  orientation-switch:
    description: Flag the port as possible handler of orientation switching
    type: boolean

  ports:
    $ref: /schemas/graph.yaml#/properties/ports

    properties:
      port@0:
        $ref: /schemas/graph.yaml#/properties/port
        description: Super Speed output lanes

      port@1:
        $ref: /schemas/graph.yaml#/properties/port
        description: Super Speed input lanes

required:
  - compatible
  - select-gpios
  - orientation-switch
  - ports

additionalProperties: false

examples:
  - |
    #include <dt-bindings/gpio/gpio.h>

    tcpm {
        connector {
            compatible = "usb-c-connector";

            ports {
                #address-cells = <1>;
                #size-cells = <0>;

                port@0 {
                    reg = <0>;
                    tcpm_hs_out: endpoint {
                        remote-endpoint = <&usb_hs_phy_in>;
                    };
                };

                port@1 {
                    reg = <1>;
                    tcpm_ss_out: endpoint {
                        remote-endpoint = <&usb_ss_switch_in>;
                    };
                };

                port@2 {
                    reg = <2>;
                    tcpm_sbu_out: endpoint {
                        remote-endpoint = <&sbu_mux_in>;
                    };
                };
            };
        };
    };

    superspeed-mux {
        compatible = "wcn,ch482d", "gpio-superspeed-switch";

        select-gpios = <&gpio 7 GPIO_ACTIVE_LOW>;

        orientation-switch;

        ports {
            #address-cells = <1>;
            #size-cells = <0>;

            port@0 {
                reg = <0>;
                usb_ss_switch_out: endpoint {
                    remote-endpoint = <&tcpm_ss_out>;
                };
            };

            port@1 {
                reg = <1>;
                usb_ss_switch_in: endpoint {
                    remote-endpoint = <&usb_ss_phy_in>;
                };
            };
        };
    };
...
```

## Documentation/devicetree/bindings/watchdog/amlogic,meson6-wdt.yaml
```yaml
# SPDX-License-Identifier: (GPL-2.0-only OR BSD-2-Clause)
%YAML 1.2
---
$id: http://devicetree.org/schemas/watchdog/amlogic,meson6-wdt.yaml#
$schema: http://devicetree.org/meta-schemas/core.yaml#

title: Amlogic Meson6 SoCs Watchdog timer

maintainers:
  - Neil Armstrong <neil.armstrong@linaro.org>
  - Martin Blumenstingl <martin.blumenstingl@googlemail.com>

allOf:
  - $ref: watchdog.yaml#

properties:
  compatible:
    enum:
      - amlogic,meson6-wdt
      - amlogic,meson8-wdt
      - amlogic,meson8b-wdt
      - amlogic,meson8m2-wdt

  reg:
    maxItems: 1

required:
  - compatible
  - reg

unevaluatedProperties: false

examples:
  - |
    wdt: watchdog@c1109900 {
        compatible = "amlogic,meson6-wdt";
        reg = <0xc1109900 0x8>;
        timeout-sec = <10>;
    };
```
