## Documentation/devicetree/bindings/phy/qcom,sc8280xp-qmp-usb43dp-phy.yaml
```yaml
# SPDX-License-Identifier: (GPL-2.0 OR BSD-2-Clause)
%YAML 1.2
---
$id: http://devicetree.org/schemas/phy/qcom,sc8280xp-qmp-usb43dp-phy.yaml#
$schema: http://devicetree.org/meta-schemas/core.yaml#

title: Qualcomm QMP USB4-USB3-DP PHY controller (SC8280XP)

maintainers:
  - Vinod Koul <vkoul@kernel.org>

description:
  The QMP PHY controller supports physical layer functionality for a number of
  controllers on Qualcomm chipsets, such as, PCIe, UFS and USB.

properties:
  compatible:
    enum:
      - qcom,sar2130p-qmp-usb3-dp-phy
      - qcom,sc7180-qmp-usb3-dp-phy
      - qcom,sc7280-qmp-usb3-dp-phy
      - qcom,sc8180x-qmp-usb3-dp-phy
      - qcom,sc8280xp-qmp-usb43dp-phy
      - qcom,sdm845-qmp-usb3-dp-phy
      - qcom,sm6350-qmp-usb3-dp-phy
      - qcom,sm8150-qmp-usb3-dp-phy
      - qcom,sm8250-qmp-usb3-dp-phy
      - qcom,sm8350-qmp-usb3-dp-phy
      - qcom,sm8450-qmp-usb3-dp-phy
      - qcom,sm8550-qmp-usb3-dp-phy
      - qcom,sm8650-qmp-usb3-dp-phy
      - qcom,sm8750-qmp-usb3-dp-phy
      - qcom,x1e80100-qmp-usb3-dp-phy

  reg:
    maxItems: 1

  clocks:
    minItems: 4
    maxItems: 5

  clock-names:
    minItems: 4
    items:
      - const: aux
      - const: ref
      - const: com_aux
      - const: usb3_pipe
      - const: cfg_ahb

  power-domains:
    maxItems: 1

  resets:
    maxItems: 2

  reset-names:
    items:
      - const: phy
      - const: common

  vdda-phy-supply: true

  vdda-pll-supply: true

  "#clock-cells":
    const: 1
    description:
      See include/dt-bindings/phy/phy-qcom-qmp.h

  "#phy-cells":
    const: 1
    description:
      See include/dt-bindings/phy/phy-qcom-qmp.h

  mode-switch: true
  orientation-switch: true

  qcom,static-lanes-mapping:
    $ref: /schemas/types.yaml#/definitions/uint32-array
    minItems: 4
    items:
      enum:
        - 0 # Unconnected (PHY_NONE)
        - 4 # USB3 (PHY_TYPE_USB3)
        - 6 # DisplayPort (PHY_TYPE_DP)
    description:
      Describes the static mapping of the Combo PHY lanes, when not used
      a in a Type-C dynamic setup using USB-C PD Events to change the mapping.
      The 4 lanes can either routed to the underlying DP PHY or the USB3 PHY.
      Only 2 of the lanes can be connected to the USB3 PHY, but the 4 lanes can
      be connected to the DP PHY.
      The numbers corresponds to the PHY Type the lanes are connected to.
      The possible combinations are
        <0 0 0 0> when none are connected
        <4 4 0 6> USB3 and DP single lane
        <4 4 6 6> USB3 and DP
        <6 6 4 4> DP and USB3
        <6 0 4 4> DP and USB3 single lane
        <4 4 0 0> USB3 Only
        <0 0 4 4> USB3 Only
        <6 0 0 0> DP single lane
        <0 0 0 6> DP single lane
        <6 6 0 0> DP 2 lanes
        <0 0 6 6> DP 2 lanes
        <6 6 6 6> DP 4 lanes

  ports:
    $ref: /schemas/graph.yaml#/properties/ports
    properties:
      port@0:
        $ref: /schemas/graph.yaml#/properties/port
        description: Output endpoint of the PHY

      port@1:
        $ref: /schemas/graph.yaml#/properties/port
        description: Incoming endpoint from the USB controller

      port@2:
        $ref: /schemas/graph.yaml#/properties/port
        description: Incoming endpoint from the DisplayPort controller

required:
  - compatible
  - reg
  - clocks
  - clock-names
  - resets
  - reset-names
  - vdda-phy-supply
  - vdda-pll-supply
  - "#clock-cells"
  - "#phy-cells"

allOf:
  - $ref: /schemas/usb/usb-switch.yaml#
  - if:
      properties:
        compatible:
          enum:
            - qcom,sc7180-qmp-usb3-dp-phy
            - qcom,sdm845-qmp-usb3-dp-phy
    then:
      properties:
        clocks:
          maxItems: 5
        clock-names:
          maxItems: 5
    else:
      properties:
        clocks:
          maxItems: 4
        clock-names:
          maxItems: 4

  - if:
      properties:
        compatible:
          enum:
            - qcom,sar2130p-qmp-usb3-dp-phy
            - qcom,sc8280xp-qmp-usb43dp-phy
            - qcom,sm6350-qmp-usb3-dp-phy
            - qcom,sm8550-qmp-usb3-dp-phy
            - qcom,sm8650-qmp-usb3-dp-phy
            - qcom,sm8750-qmp-usb3-dp-phy
            - qcom,x1e80100-qmp-usb3-dp-phy
    then:
      required:
        - power-domains
    else:
      properties:
        power-domains: false

additionalProperties: false

examples:
  - |
    #include <dt-bindings/clock/qcom,gcc-sc8280xp.h>

    phy@88eb000 {
      compatible = "qcom,sc8280xp-qmp-usb43dp-phy";
      reg = <0x088eb000 0x4000>;

      clocks = <&gcc GCC_USB3_PRIM_PHY_AUX_CLK>,
               <&gcc GCC_USB4_EUD_CLKREF_CLK>,
               <&gcc GCC_USB3_PRIM_PHY_COM_AUX_CLK>,
               <&gcc GCC_USB3_PRIM_PHY_PIPE_CLK>;
      clock-names = "aux", "ref", "com_aux", "usb3_pipe";

      power-domains = <&gcc USB30_PRIM_GDSC>;

      resets = <&gcc GCC_USB3_PHY_PRIM_BCR>,
               <&gcc GCC_USB4_DP_PHY_PRIM_BCR>;
      reset-names = "phy", "common";

      vdda-phy-supply = <&vreg_l9d>;
      vdda-pll-supply = <&vreg_l4d>;

      orientation-switch;

      #clock-cells = <1>;
      #phy-cells = <1>;

      ports {
          #address-cells = <1>;
          #size-cells = <0>;

          port@0 {
              reg = <0>;

              endpoint {
                  remote-endpoint = <&typec_connector_ss>;
              };
          };

          port@1 {
              reg = <1>;

              endpoint {
                  remote-endpoint = <&dwc3_ss_out>;
              };
          };

          port@2 {
              reg = <2>;

              endpoint {
                  remote-endpoint = <&mdss_dp_out>;
              };
          };
      };
    };
```

## Documentation/devicetree/bindings/phy/qcom,snps-eusb2-phy.yaml
```yaml
# SPDX-License-Identifier: (GPL-2.0 OR BSD-2-Clause)

%YAML 1.2
---
$id: "http://devicetree.org/schemas/phy/qcom,snps-eusb2-phy.yaml#"
$schema: "http://devicetree.org/meta-schemas/core.yaml#"

title: Qualcomm SNPS eUSB2 phy controller

maintainers:
  - Abel Vesa <abel.vesa@linaro.org>

description:
  eUSB2 controller supports LS/FS/HS usb connectivity on Qualcomm chipsets.

properties:
  compatible:
    const: qcom,sm8550-snps-eusb2-phy

  reg:
    maxItems: 1

  "#phy-cells":
    const: 0

  clocks:
    items:
      - description: ref src
      - description: ref

  clock-names:
    items:
      - const: ref_src
      - const: ref

  usb-repeater:
    description:
      Phandle to eUSB2 to USB 2.0 repeater

  vdd-supply:
    description:
      Phandle to 0.88V regulator supply to PHY digital circuit.

  vdda12-supply:
    description:
      Phandle to 1.2V regulator supply to PHY refclk pll block.

  resets:
    maxItems: 1
    description:
      Phandle to reset to phy block.

required:
  - compatible
  - reg
  - "#phy-cells"
  - clocks
  - clock-names
  - vdd-supply
  - vdda12-supply
  - resets

additionalProperties: false

examples:
  - |
    #include <dt-bindings/clock/qcom,gcc-sm8550.h>
    #include <dt-bindings/clock/qcom,rpmh.h>
    #include <dt-bindings/clock/qcom,tcsrcc-sm8550.h>

    usb_1_hsphy: phy@88e3000 {
        compatible = "qcom,sm8550-snps-eusb2-phy";
        reg = <0x88e3000 0x154>;
        #phy-cells = <0>;

        clocks = <&rpmhcc RPMH_CXO_PAD_CLK>,
                 <&tcsrcc TCSR_USB2_CLKREF_EN>;
        clock-names = "ref_src", "ref";

        vdd-supply = <&vreg_l1e_0p88>;
        vdda12-supply = <&vreg_l3e_1p2>;

        resets = <&gcc GCC_QUSB2PHY_PRIM_BCR>;
    };
```

## Documentation/devicetree/bindings/pinctrl/amlogic,meson-pinctrl.yaml
```yaml
# SPDX-License-Identifier: (GPL-2.0-only OR BSD-2-Clause)
%YAML 1.2
---
$id: http://devicetree.org/schemas/pinctrl/amlogic,meson-pinctrl.yaml#
$schema: http://devicetree.org/meta-schemas/core.yaml#

title: Amlogic Meson pinmux controller

maintainers:
  - Neil Armstrong <neil.armstrong@linaro.org>

allOf:
  - $ref: pinctrl.yaml#

properties:
  compatible:
    minItems: 1
    maxItems: 2
    oneOf:
      - items:
          - enum:
              - amlogic,meson8-cbus-pinctrl
              - amlogic,meson8b-cbus-pinctrl
              - amlogic,meson8m2-cbus-pinctrl
              - amlogic,meson8-aobus-pinctrl
              - amlogic,meson8b-aobus-pinctrl
              - amlogic,meson8m2-aobus-pinctrl
              - amlogic,meson-gxbb-periphs-pinctrl
              - amlogic,meson-gxbb-aobus-pinctrl
              - amlogic,meson-gxl-periphs-pinctrl
              - amlogic,meson-gxl-aobus-pinctrl
              - amlogic,meson-axg-periphs-pinctrl
              - amlogic,meson-axg-aobus-pinctrl
              - amlogic,meson-g12a-periphs-pinctrl
              - amlogic,meson-g12a-aobus-pinctrl
              - amlogic,meson-a1-periphs-pinctrl
              - amlogic,meson-s4-periphs-pinctrl
      - items:
          - const: amlogic,meson8m2-aobus-pinctrl
          - const: amlogic,meson8-aobus-pinctrl
      - items:
          - const: amlogic,meson8m2-cbus-pinctrl
          - const: amlogic,meson8-cbus-pinctrl

  ranges: true

  "#address-cells":
    enum: [1, 2]

  "#size-cells":
    enum: [1, 2]

required:
  - compatible
  - ranges
  - "#address-cells"
  - "#size-cells"

additionalProperties:
  anyOf:
    - type: object
      allOf:
        - $ref: pincfg-node.yaml#
        - $ref: pinmux-node.yaml#

patternProperties:
  "^bank@[0-9]$":
    type: object
    properties:
      reg:
        minItems: 5
        maxItems: 5

      reg-names:
        items:
          - const: gpio
          - const: pull
          - const: pull-enable
          - const: mux
          - const: ds

      gpio-controller: true

      "#gpio-cells":
        const: 2

      gpio-ranges:
        $ref: /schemas/types.yaml#/definitions/phandle

    required:
      - reg
      - reg-names
      - gpio-controller
      - "#gpio-cells"
      - gpio-ranges

examples:
  - |
    pinctrl {
      compatible = "amlogic,meson-g12a-periphs-pinctrl";
      #address-cells = <1>;
      #size-cells = <1>;
      ranges;

      bank@40 {
        reg = <0x0 0x40  0x0 0x4c>,
              <0x0 0xe8  0x0 0x18>,
              <0x0 0x120 0x0 0x18>,
              <0x0 0x2c0 0x0 0x40>,
              <0x0 0x340 0x0 0x1c>;
        reg-names = "gpio", "pull", "pull-enable", "mux", "ds";
        gpio-controller;
        #gpio-cells = <2>;
        gpio-ranges = <&periphs_pinctrl 0 0 86>;
      };

      cec_ao_a_h_pins: cec_ao_a_h {
        mux {
          groups = "cec_ao_a_h";
          function = "cec_ao_a_h";
          bias-disable;
        };
      };
    };
```

## Documentation/devicetree/bindings/pinctrl/qcom,mdm9615-pinctrl.yaml
```yaml
# SPDX-License-Identifier: (GPL-2.0-only OR BSD-2-Clause)
%YAML 1.2
---
$id: http://devicetree.org/schemas/pinctrl/qcom,mdm9615-pinctrl.yaml#
$schema: http://devicetree.org/meta-schemas/core.yaml#

title: Qualcomm Technologies, Inc. MDM9615 TLMM block

maintainers:
  - Bjorn Andersson <andersson@kernel.org>

description: |
  This binding describes the Top Level Mode Multiplexer block found in the
  MDM9615 platform.

allOf:
  - $ref: "pinctrl.yaml#"
  - $ref: /schemas/pinctrl/qcom,tlmm-common.yaml#

properties:
  compatible:
    const: qcom,mdm9615-pinctrl

  reg:
    maxItems: 1

  interrupts: true
  interrupt-controller: true
  '#interrupt-cells': true
  gpio-controller: true
  '#gpio-cells': true
  gpio-ranges: true

required:
  - compatible
  - reg

additionalProperties: false

patternProperties:
  '-state$':
    oneOf:
      - $ref: "#/$defs/qcom-mdm9615-pinctrl-state"
      - patternProperties:
          "-pins$":
            $ref: "#/$defs/qcom-mdm9615-pinctrl-state"

'$defs':
  qcom-mdm9615-pinctrl-state:
    type: object
    description:
      Pinctrl node's client devices use subnodes for desired pin configuration.
      Client device subnodes use below standard properties.
    $ref: "qcom,tlmm-common.yaml#/$defs/qcom-tlmm-state"

    properties:
      pins:
        description:
          List of gpio pins affected by the properties specified in this
          subnode.
        items:
          oneOf:
            - pattern: "^gpio([0-9]|[1-7][0-9]|8[0-7])$"
        minItems: 1
        maxItems: 16

      function:
        description:
          Specify the alternative function to be configured for the specified
          pins.

        enum: [ gpio, gsbi2_i2c, gsbi3, gsbi4, gsbi5_i2c, gsbi5_uart,
                sdc2, ebi2_lcdc, ps_hold, prim_audio, sec_audio, cdc_mclk, ]

      bias-disable: true
      bias-pull-down: true
      bias-pull-up: true
      drive-strength: true
      output-high: true
      output-low: true
      input-enable: true

    required:
      - pins
      - function

    additionalProperties: false

examples:
  - |
        #include <dt-bindings/interrupt-controller/arm-gic.h>
        tlmm: pinctrl@1000000 {
          compatible = "qcom,mdm9615-pinctrl";
          reg = <0x01000000 0x300000>;
          interrupts = <GIC_SPI 208 IRQ_TYPE_LEVEL_HIGH>;
          gpio-controller;
          gpio-ranges = <&msmgpio 0 0 88>;
          #gpio-cells = <2>;
          interrupt-controller;
          #interrupt-cells = <2>;
        };
```

## Documentation/devicetree/bindings/power/reset/hardkernel,odroid-go-ultra-poweroff.yaml
```yaml
# SPDX-License-Identifier: GPL-2.0
%YAML 1.2
---
$id: http://devicetree.org/schemas/power/reset/hardkernel,odroid-go-ultra-poweroff.yaml#
$schema: http://devicetree.org/meta-schemas/core.yaml#

title: Hardkernel Odroid Go Ultra poweroff

maintainers:
  - Neil Armstrong <neil.armstrong@linaro.org>

description:
  The Hardkernel Odroid Go Ultra poweroff scheme requires requesting a poweroff
  to its two PMICs in order, this represents the poweroff scheme needed to complete
  a clean poeroff of the system.

properties:
  compatible:
    const: hardkernel,odroid-go-ultra-poweroff

  hardkernel,rk817-pmic:
    $ref: /schemas/types.yaml#/definitions/phandle
    description: Phandle to the RK817 PMIC node

  hardkernel,rk818-pmic:
    $ref: /schemas/types.yaml#/definitions/phandle
    description: Phandle to the RK818 PMIC node

required:
  - compatible
  - hardkernel,rk817-pmic
  - hardkernel,rk818-pmic

additionalProperties: false

examples:
  - |
    poweroff {
        compatible = "hardkernel,odroid-go-ultra-poweroff";
        hardkernel,rk817-pmic = <&rk817>;
        hardkernel,rk818-pmic = <&rk818>;
    };
```
