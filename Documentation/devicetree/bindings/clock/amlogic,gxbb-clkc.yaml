## Documentation/devicetree/bindings/iio/adc/qcom,spmi-vadc.yaml
```yaml
# SPDX-License-Identifier: GPL-2.0-only
%YAML 1.2
---
$id: http://devicetree.org/schemas/iio/adc/qcom,spmi-vadc.yaml#
$schema: http://devicetree.org/meta-schemas/core.yaml#

title: Qualcomm's SPMI PMIC ADC

maintainers:
  - Andy Gross <agross@kernel.org>
  - Bjorn Andersson <bjorn.andersson@linaro.org>

description: |
  SPMI PMIC voltage ADC (VADC) provides interface to clients to read
  voltage. The VADC is a 15-bit sigma-delta ADC.
  SPMI PMIC5/PMIC7/PMIC5 Gen3 voltage ADC voltage ADC (ADC) provides
  interface to clients to read voltage. The VADC is a 16-bit sigma-delta ADC.
  Note that PMIC7 ADC is the generation between PMIC5 and PMIC5 Gen3 ADC,
  it can be considered like PMIC5 Gen2.
  In addition, PMIC5 Gen3 ADC also performs the same thermal monitoring function
  as the existing ADC_TM devices.

properties:
  compatible:
    oneOf:
      - items:
          - const: qcom,pms405-adc
          - const: qcom,spmi-adc-rev2
      - enum:
          - qcom,spmi-adc-rev2
          - qcom,spmi-adc5
          - qcom,spmi-adc5-gen3
          - qcom,spmi-adc7
          - qcom,spmi-vadc

  reg:
    description:
      For compatible properties "qcom,spmi-vadc", "qcom,spmi-adc5", "qcom,spmi-adc-rev2"
      and "qcom,spmi-adc7", reg is the VADC base address in the SPMI PMIC register map.
      For compatible property "qcom,spmi-adc5-gen3", each reg corresponds to an SDAM
      peripheral base address that is being used for ADC functionality.
    minItems: 1
    maxItems: 2

  '#address-cells':
    const: 1

  '#size-cells':
    const: 0

  "#thermal-sensor-cells":
    const: 1
    description:
      Number of cells required to uniquely identify the thermal sensors.
      For compatible property "qcom,spmi-adc5-gen3", this property is
      required for if any channels under it are used for ADC_TM.
      Since we have multiple sensors this is set to 1.

  '#io-channel-cells':
    const: 1

  interrupts:
    description:
      End of conversion interrupt.
      For compatible property "qcom,spmi-adc5-gen3", interrupts are defined
      for each SDAM being used.
    minItems: 1
    maxItems: 2

  interrupt-names:
    minItems: 1
    maxItems: 2

patternProperties:
  "^channel@[0-9a-f]+$":
    type: object
    additionalProperties: false
    description: |
      Represents the external channels which are connected to the ADC.
      For compatible property "qcom,spmi-vadc" following channels, also known as
      reference point channels, are used for result calibration and their channel
      configuration nodes should be defined:
      VADC_REF_625MV and/or VADC_SPARE1(based on PMIC version) VADC_REF_1250MV,
      VADC_GND_REF and VADC_VDD_VADC.

    properties:
      reg:
        maxItems: 1
        description: |
          ADC channel number.
          See include/dt-bindings/iio/adc/qcom,spmi-vadc.h
          For PMIC7 and PMIC5 Gen3 ADC, the channel numbers are specified separately
          per PMIC in the PMIC-specific files in include/dt-bindings/iio/adc.

      label:
        description: |
            ADC input of the platform as seen in the schematics.
            For thermistor inputs connected to generic AMUX or GPIO inputs
            these can vary across platform for the same pins. Hence select
            the platform schematics name for this channel.

      qcom,decimation:
        $ref: /schemas/types.yaml#/definitions/uint32
        description: |
            This parameter is used to decrease ADC sampling rate.
            Quicker measurements can be made by reducing decimation ratio.

      qcom,pre-scaling:
        description: |
            Used for scaling the channel input signal before the signal is
            fed to VADC. The configuration for this node is to know the
            pre-determined ratio and use it for post scaling. It is a pair of
            integers, denoting the numerator and denominator of the fraction by which
            input signal is multiplied. For example, <1 3> indicates the signal is scaled
            down to 1/3 of its value before ADC measurement.
            If property is not found default value depending on chip will be used.
        $ref: /schemas/types.yaml#/definitions/uint32-array
        oneOf:
          - items:
              - const: 1
              - enum: [ 1, 3, 4, 6, 20, 8, 10, 16 ]
          - items:
              - const: 10
              - const: 81

      qcom,ratiometric:
        description: |
            Channel calibration type.
            - For compatible property "qcom,spmi-vadc", if this property is
              specified VADC will use the VDD reference (1.8V) and GND for
              channel calibration. If property is not found, channel will be
              calibrated with 0.625V and 1.25V reference channels, also
              known as absolute calibration.
            - For compatible property "qcom,spmi-adc5", "qcom,spmi-adc7",
              "qcom,spmi-adc-rev2" and "qcom,spmi-adc5-gen3", if this property is
              specified VADC will use the VDD reference (1.875V) and GND for channel
              calibration. If property is not found, channel will be calibrated with
              0V and 1.25V reference channels, also known as absolute calibration.
        type: boolean

      qcom,hw-settle-time:
        $ref: /schemas/types.yaml#/definitions/uint32
        description: |
            Time between AMUX getting configured and the ADC starting
            conversion. The 'hw_settle_time' is an index used from valid values
            and programmed in hardware to achieve the hardware settling delay.

      qcom,avg-samples:
        $ref: /schemas/types.yaml#/definitions/uint32
        description: |
            Number of samples to be used for measurement.
            Averaging provides the option to obtain a single measurement
            from the ADC that is an average of multiple samples. The value
            selected is 2^(value).

      qcom,adc-tm:
        description:
          Indicates if ADC_TM monitoring is done on this channel.
          Defined for compatible property "qcom,spmi-adc5-gen3".
          This is the same functionality as in the existing QCOM ADC_TM
          device, documented at devicetree/bindings/thermal/qcom-spmi-adc-tm5.yaml.
        type: boolean

    required:
      - reg

required:
  - compatible
  - reg
  - '#address-cells'
  - '#size-cells'
  - '#io-channel-cells'

allOf:
  - if:
      properties:
        compatible:
          contains:
            const: qcom,spmi-vadc

    then:
      properties:
        reg:
          minItems: 1
          maxItems: 1
        interrupts:
          minItems: 1
          maxItems: 1
        "#thermal-sensor-cells": false
        interrupt-names: false
      patternProperties:
        "^channel@[0-9a-f]+$":
          properties:
            qcom,decimation:
              enum: [ 512, 1024, 2048, 4096 ]
              default: 512

            qcom,hw-settle-time:
              enum: [ 0, 100, 200, 300, 400, 500, 600, 700, 800, 900, 1, 2,
                      4, 6, 8, 10 ]
              default: 0

            qcom,avg-samples:
              enum: [ 1, 2, 4, 8, 16, 32, 64, 128, 256, 512 ]
              default: 1

            qcom,adc-tm: false

  - if:
      properties:
        compatible:
          contains:
            const: qcom,spmi-adc-rev2

    then:
      properties:
        reg:
          minItems: 1
          maxItems: 1
        interrupts:
          minItems: 1
          maxItems: 1
        "#thermal-sensor-cells": false
        interrupt-names: false
      patternProperties:
        "^channel@[0-9a-f]+$":
          properties:
            qcom,decimation:
              enum: [ 256, 512, 1024 ]
              default: 1024

            qcom,hw-settle-time:
              enum: [ 0, 100, 200, 300, 400, 500, 600, 700, 800, 900, 1, 2,
                      4, 6, 8, 10 ]
              default: 0

            qcom,avg-samples:
              enum: [ 1, 2, 4, 8, 16 ]
              default: 1

            qcom,adc-tm: false

  - if:
      properties:
        compatible:
          contains:
            const: qcom,spmi-adc5

    then:
      properties:
        reg:
          minItems: 1
          maxItems: 1
        interrupts:
          minItems: 1
          maxItems: 1
        "#thermal-sensor-cells": false
        interrupt-names: false
      patternProperties:
        "^channel@[0-9a-f]+$":
          properties:
            qcom,decimation:
              enum: [ 250, 420, 840 ]
              default: 840

            qcom,hw-settle-time:
              enum: [ 15, 100, 200, 300, 400, 500, 600, 700, 800, 900, 1, 2,
                      4, 6, 8, 10, 16, 32, 64, 128 ]
              default: 15

            qcom,avg-samples:
              enum: [ 1, 2, 4, 8, 16 ]
              default: 1

            qcom,adc-tm: false

  - if:
      properties:
        compatible:
          contains:
            const: qcom,spmi-adc7

    then:
      properties:
        reg:
          minItems: 1
          maxItems: 1
        interrupts:
          minItems: 1
          maxItems: 1
        "#thermal-sensor-cells": false
        interrupt-names: false
      patternProperties:
        "^channel@[0-9a-f]+$":
          properties:
            qcom,decimation:
              enum: [ 85, 340, 1360 ]
              default: 1360

            qcom,hw-settle-time:
              enum: [ 15, 100, 200, 300, 400, 500, 600, 700, 1000, 2000, 4000,
                      8000, 16000, 32000, 64000, 128000 ]
              default: 15

            qcom,avg-samples:
              enum: [ 1, 2, 4, 8, 16 ]
              default: 1

            qcom,adc-tm: false

  - if:
      properties:
        compatible:
          contains:
            const: qcom,spmi-adc5-gen3

    then:
      properties:
        reg:
          minItems: 1
          items:
            - description: SDAM0 base address in the SPMI PMIC register map
            - description: SDAM1 base address
        interrupts:
          minItems: 1
          items:
            - description: SDAM0 end of conversion (EOC) interrupt
            - description: SDAM1 EOC interrupt
        interrupt-names:
          minItems: 1
          items:
            - const: adc-sdam0
            - const: adc-sdam1
      required:
        - interrupts
        - interrupt-names
      patternProperties:
        "^channel@[0-9a-f]+$":
          properties:
            qcom,decimation:
              enum: [ 85, 340, 1360 ]
              default: 1360

            qcom,hw-settle-time:
              enum: [ 15, 100, 200, 300, 400, 500, 600, 700, 1000, 2000, 4000,
                      8000, 16000, 32000, 64000, 128000 ]
              default: 15

            qcom,avg-samples:
              enum: [ 1, 2, 4, 8, 16 ]
              default: 1

additionalProperties: false

examples:
  - |
    pmic {
        #address-cells = <1>;
        #size-cells = <0>;

        adc@3100 {
            compatible = "qcom,spmi-vadc";
            reg = <0x3100>;
            interrupts = <0x0 0x31 0x0 0x1>;
            #address-cells = <1>;
            #size-cells = <0>;
            #io-channel-cells = <1>;

            /* Channel node */
            channel@39 {
                reg = <0x39>;
                qcom,decimation = <512>;
                qcom,ratiometric;
                qcom,hw-settle-time = <200>;
                qcom,avg-samples = <1>;
                qcom,pre-scaling = <1 3>;
            };

            channel@9 {
                reg = <0x9>;
            };

            channel@a {
                reg = <0xa>;
            };

            channel@e {
                reg = <0xe>;
            };

            channel@f {
                reg = <0xf>;
            };
        };
    };

  - |
    #include <dt-bindings/iio/adc/qcom,spmi-adc7-pmk8350.h>
    #include <dt-bindings/iio/adc/qcom,spmi-adc7-pm8350.h>
    #include <dt-bindings/interrupt-controller/irq.h>

    pmic {
        #address-cells = <1>;
        #size-cells = <0>;

        adc@3100 {
            reg = <0x3100>;
            compatible = "qcom,spmi-adc7";
            #address-cells = <1>;
            #size-cells = <0>;
            #io-channel-cells = <1>;

            /* Other properties are omitted */
            channel@44 {
                reg = <PMK8350_ADC7_AMUX_THM1_100K_PU>;
                qcom,ratiometric;
                qcom,hw-settle-time = <200>;
                label = "xo_therm";
            };

            channel@47 {
                reg = <PM8350_ADC7_AMUX_THM4_100K_PU(1)>;
                qcom,ratiometric;
                qcom,hw-settle-time = <200>;
                label = "conn_therm";
            };
        };
    };

  - |
    #include <dt-bindings/iio/adc/qcom,spmi-adc5-gen3-pmk8550.h>
    #include <dt-bindings/iio/adc/qcom,spmi-adc5-gen3-pm8550.h>
    #include <dt-bindings/iio/adc/qcom,spmi-adc5-gen3-pm8550b.h>
    #include <dt-bindings/iio/adc/qcom,spmi-adc5-gen3-pm8550vx.h>
    #include <dt-bindings/interrupt-controller/irq.h>

    pmic {
      #address-cells = <1>;
      #size-cells = <0>;

      adc@9000 {
        compatible = "qcom,spmi-adc5-gen3";
        reg = <0x9000>, <0x9100>;
        interrupts = <0x0 0x90 0x1 IRQ_TYPE_EDGE_RISING>,
                      <0x0 0x91 0x1 IRQ_TYPE_EDGE_RISING>;
        interrupt-names = "adc-sdam0", "adc-sdam1";
        #address-cells = <1>;
        #size-cells = <0>;
        #io-channel-cells = <1>;
        #thermal-sensor-cells = <1>;

        /* PMK8550 Channel nodes */
        channel@3 {
          reg = <PMK8550_ADC5_GEN3_DIE_TEMP(0)>;
          label = "pmk8550_die_temp";
          qcom,pre-scaling = <1 1>;
        };

        channel@44 {
          reg = <PMK8550_ADC5_GEN3_AMUX_THM1_XO_THERM_100K_PU(0)>;
          label = "pmk8550_xo_therm";
          qcom,pre-scaling = <1 1>;
          qcom,ratiometric;
          qcom,hw-settle-time = <200>;
          qcom,adc-tm;
        };

        /* PM8550 Channel nodes */
        channel@103 {
          reg = <PM8550_ADC5_GEN3_DIE_TEMP(1)>;
          label = "pm8550_die_temp";
          qcom,pre-scaling = <1 1>;
        };

        /* PM8550B Channel nodes */
        channel@78f {
          reg = <PM8550B_ADC5_GEN3_VBAT_SNS_QBG(7)>;
          label = "pm8550b_vbat_sns_qbg";
          qcom,pre-scaling = <1 3>;
        };

        /* PM8550VS_C Channel nodes */
        channel@203 {
          reg = <PM8550VS_ADC5_GEN3_DIE_TEMP(2)>;
          label = "pm8550vs_c_die_temp";
          qcom,pre-scaling = <1 1>;
        };
      };
    };
```
