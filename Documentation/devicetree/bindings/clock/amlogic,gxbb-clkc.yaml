## drivers/iio/trigger/Kconfig
```kconfig
# SPDX-License-Identifier: GPL-2.0-only
#
# Industrial I/O standalone triggers
#
# When adding new entries keep the list in alphabetical order

menu "Triggers - standalone"

config IIO_HRTIMER_TRIGGER
	tristate "High resolution timer trigger"
	depends on IIO_SW_TRIGGER
	help
	  Provides a frequency based IIO trigger using high resolution
	  timers as interrupt source.

	  To compile this driver as a module, choose M here: the
	  module will be called iio-trig-hrtimer.

config IIO_STM32_LPTIMER_TRIGGER
	tristate "STM32 Low-Power Timer Trigger"
	depends on MFD_STM32_LPTIMER || COMPILE_TEST
	help
	  Select this option to enable STM32 Low-Power Timer Trigger.
	  This can be used as trigger source for STM32 internal ADC
	  and/or DAC.

	  To compile this driver as a module, choose M here: the
	  module will be called stm32-lptimer-trigger.

config IIO_MAX34417_TRIGGER
	tristate "Analog Devices MAX34417 Bulk I2C trigger"
	depends on I2C
	help
	  Provides an IIO trigger for the MAX34417 power accumulator.
	  This trigger uses the I2C broadcast address (0x2c) to send a
	  synchronized UPDATE command to all MAX34417 devices on the same
	  I2C bus, ensuring perfectly synchronized latching of power data
	  across multiple chips.

	  To compile this driver as a module, choose M here: the
	  module will be called iio-trig-max34417.

config IIO_STM32_TIMER_TRIGGER
	tristate "STM32 Timer Trigger"
	depends on (ARCH_STM32 && MFD_STM32_TIMERS) || COMPILE_TEST
	help
	  Select this option to enable STM32 Timer Trigger

	  To compile this driver as a module, choose M here: the
	  module will be called stm32-timer-trigger.

config IIO_TIGHTLOOP_TRIGGER
	tristate "A kthread based hammering loop trigger"
	depends on IIO_SW_TRIGGER
	help
	  An experimental trigger, used to allow sensors to be sampled as fast
	  as possible under the limitations of whatever else is going on.
	  Uses a tight loop in a kthread.  Will only work with lower half only
	  trigger consumers.

	  To compile this driver as a module, choose M here: the
	  module will be called iio-trig-loop.

config IIO_SYSFS_TRIGGER
	tristate "SYSFS trigger"
	depends on SYSFS
	select IRQ_WORK
	help
	  Provides support for using SYSFS entries as IIO triggers.
	  If unsure, say N (but it's safe to say "Y").

	  To compile this driver as a module, choose M here: the
	  module will be called iio-trig-sysfs.

endmenu
```

## drivers/media/platform/qcom/iris/Kconfig
```kconfig
config VIDEO_QCOM_IRIS
        tristate "Qualcomm Iris V4L2 decoder driver"
        depends on VIDEO_DEV
        depends on ARCH_QCOM || COMPILE_TEST
        select QCOM_MDT_LOADER if ARCH_QCOM
        select QCOM_SCM
        help
          This is a V4L2 driver for Qualcomm Iris video accelerator
          hardware. It accelerates decoding operations on various
          Qualcomm SoCs.
          To compile this driver as a module choose m here.
```

## drivers/pci/pcie/pwrseq/Kconfig
```kconfig
# SPDX-License-Identifier: GPL-2.0

menuconfig PCIE_PWRSEQ
	bool "PCIe Power Sequencing support"
	depends on PCIEPORTBUS
	help
	  Say yes here to enable support for PCIe power sequencing
	  drivers.
```
